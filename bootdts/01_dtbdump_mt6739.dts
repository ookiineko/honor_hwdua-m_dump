/dts-v1/;

/ {
	#address-cells = <0x2>;
	#size-cells = <0x2>;
	compatible = "mediatek,mt6739";
	interrupt-parent = <0x1>;
	model = "mt6739";

	Volt_Control {
		compatible = "dura_VoltControl";
		linux,phandle = <0x73>;
		phandle = <0x73>;
	};

	__symbols__ {
		DPIDLE = "/cpus/idle-states/dpidle";
		MCDI_CLUSTER = "/cpus/idle-states/mcdi-cluster";
		MCDI_CPU = "/cpus/idle-states/mcdi-cpu";
		SODI = "/cpus/idle-states/sodi";
		SODI3 = "/cpus/idle-states/sodi3";
		STANDBY = "/cpus/idle-states/standby";
		SUSPEND = "/cpus/idle-states/suspend";
		Volt_Control = "/Volt_Control";
		accdet = "/accdet";
		als = "/als_ps@0";
		apmixed = "/apmixed@1000c000";
		apuart0 = "/apuart0@11002000";
		apuart1 = "/apuart1@11003000";
		audgpio = "/mt_soc_dl1_pcm@11220000";
		audio = "/audio@11220000";
		auxadc = "/auxadc@11001000";
		bat_gm30 = "/bat_gm30";
		board_id = "/board_id";
		charger = "/charger";
		chosen = "/chosen";
		chr_stat = "/chr_stat";
		clk26m = "/clk26m";
		clk32k = "/clk32k";
		consys = "/consys@18070000";
		cpu0 = "/cpus/cpu@0";
		cpu1 = "/cpus/cpu@001";
		cpu2 = "/cpus/cpu@002";
		cpu3 = "/cpus/cpu@003";
		cpu_dbgapb = "/cpu_dbgapb";
		disp_aal0 = "/disp_aal0@1400f000";
		disp_mutex = "/disp_mutex@14001000";
		disp_ovl0 = "/disp_ovl0@1400a000";
		dispsys = "/dispsys@14000000";
		dsi_te = "/dsi_te";
		eint_acc = "/eint_acc";
		eint_alps = "/eint_alps";
		eint_ctp = "/eint_ctp";
		eint_ear = "/eint_ear";
		flashlight_core = "/flashlight_core";
		flashlights_aw3643 = "/flashlights_aw3643";
		flashlights_rt4505 = "/flashlights_rt4505";
		fp_int_n = "/fp_int_n";
		gic = "/interrupt-controller@0c000000";
		gpio = "/gpio@10005000";
		gpio_usage_mapping = "/gpio";
		gse_1 = "/gse_1";
		gyro = "/gyro";
		i2c0 = "/i2c@11007000";
		i2c1 = "/i2c@11008000";
		i2c2 = "/i2c@11009000";
		i2c3 = "/i2c@1100f000";
		i2c4 = "/i2c@11011000";
		i2c5 = "/i2c@11016000";
		imgsys_config = "/imgsys_config@15000000";
		infracfg_ao = "/infracfg_ao@10001000";
		int_sar_sensor = "/int_sar_sensor";
		irq_nfc = "/irq_nfc";
		irtx_pwm = "/irtx_pwm";
		kd_camera_hw1 = "/kd_camera_hw1@15008000";
		keypad = "/kp@10010000";
		led_simple = "/led_simple";
		main_pmic = "/pwrap@1000d000/pmic_irq";
		md1_sim1_hot_plug_eint = "/md1_sim1_hot_plug_eint";
		md1_sim2_hot_plug_eint = "/md1_sim2_hot_plug_eint";
		mdcldma = "/mdcldma@10014000";
		mdp_rdma0 = "/mdp_rdma0@14004000";
		mdp_rsz0 = "/mdp_rsz0@14005000";
		mdp_rsz1 = "/mdp_rsz1@14006000";
		mdp_tdshp0 = "/mdp_tdshp0@14009000";
		mdp_wdma0 = "/mdp_wdma0@14007000";
		mdp_wrot0 = "/mdp_wrot0@14008000";
		mm_mutex = "/mm_mutex@14016000";
		mmsys_config = "/mmsys_config@14000000";
		mrdump_ext_rst = "/mrdump_ext_rst";
		msdc0 = "/msdc@11230000";
		msdc0_pins_default = "/msdc@11230000/msdc0@default";
		msdc0_register_setting_default = "/msdc@11230000/msdc0@register_default";
		msdc1 = "/msdc@11240000";
		msdc1_ins = "/msdc1_ins";
		msdc1_pins_ddr50 = "/msdc@11240000/msdc1@ddr50";
		msdc1_pins_default = "/msdc@11240000/msdc1@default";
		msdc1_pins_sdr104 = "/msdc@11240000/msdc1@sdr104";
		msdc1_pins_sdr50 = "/msdc@11240000/msdc1@sdr50";
		msdc1_register_setting_default = "/msdc@11240000/msdc1@register_default";
		mse = "/mse";
		mt_charger = "/mt_charger";
		mt_pmic_vaud28_ldo_reg = "/mt_pmic_regulator/ldo_regulators/ldo_vaud28";
		mt_pmic_vaux18_ldo_reg = "/mt_pmic_regulator/ldo_regulators/ldo_vaux18";
		mt_pmic_vcama_ldo_reg = "/mt_pmic_regulator/ldo_regulators/ldo_vcama";
		mt_pmic_vcamd_ldo_reg = "/mt_pmic_regulator/ldo_regulators/ldo_vcamd";
		mt_pmic_vcamio_ldo_reg = "/mt_pmic_regulator/ldo_regulators/ldo_vcamio";
		mt_pmic_vcn18_ldo_reg = "/mt_pmic_regulator/ldo_regulators/ldo_vcn18";
		mt_pmic_vcn28_ldo_reg = "/mt_pmic_regulator/ldo_regulators/ldo_vcn28";
		mt_pmic_vcn33_bt_ldo_reg = "/mt_pmic_regulator/ldo_regulators/ldo_vcn33_bt";
		mt_pmic_vcn33_wifi_ldo_reg = "/mt_pmic_regulator/ldo_regulators/ldo_vcn33_wifi";
		mt_pmic_vcore_buck_reg = "/mt_pmic_regulator/buck_regulators/buck_vcore";
		mt_pmic_vdram_ldo_reg = "/mt_pmic_regulator/ldo_regulators/ldo_vdram";
		mt_pmic_vefuse_ldo_reg = "/mt_pmic_regulator/ldo_regulators/ldo_vefuse";
		mt_pmic_vemc_ldo_reg = "/mt_pmic_regulator/ldo_regulators/ldo_vemc";
		mt_pmic_vfe28_ldo_reg = "/mt_pmic_regulator/ldo_regulators/ldo_vfe28";
		mt_pmic_vibr_ldo_reg = "/mt_pmic_regulator/ldo_regulators/ldo_vibr";
		mt_pmic_vio18_ldo_reg = "/mt_pmic_regulator/ldo_regulators/ldo_vio18";
		mt_pmic_vio28_ldo_reg = "/mt_pmic_regulator/ldo_regulators/ldo_vio28";
		mt_pmic_vldo28_ldo_reg = "/mt_pmic_regulator/ldo_regulators/ldo_vldo28";
		mt_pmic_vmc_ldo_reg = "/mt_pmic_regulator/ldo_regulators/ldo_vmc";
		mt_pmic_vmch_ldo_reg = "/mt_pmic_regulator/ldo_regulators/ldo_vmch";
		mt_pmic_vmodem_buck_reg = "/mt_pmic_regulator/buck_regulators/buck_vmodem";
		mt_pmic_vpa_buck_reg = "/mt_pmic_regulator/buck_regulators/buck_vpa";
		mt_pmic_vproc_buck_reg = "/mt_pmic_regulator/buck_regulators/buck_vproc";
		mt_pmic_vrf12_ldo_reg = "/mt_pmic_regulator/ldo_regulators/ldo_vrf12";
		mt_pmic_vrf18_ldo_reg = "/mt_pmic_regulator/ldo_regulators/ldo_vrf18";
		mt_pmic_vs1_buck_reg = "/mt_pmic_regulator/buck_regulators/buck_vs1";
		mt_pmic_vsim1_ldo_reg = "/mt_pmic_regulator/ldo_regulators/ldo_vsim1";
		mt_pmic_vsim2_ldo_reg = "/mt_pmic_regulator/ldo_regulators/ldo_vsim2";
		mt_pmic_vsram_others_ldo_reg = "/mt_pmic_regulator/ldo_regulators/ldo_vsram_others";
		mt_pmic_vsram_proc_ldo_reg = "/mt_pmic_regulator/ldo_regulators/ldo_vsram_proc";
		mt_pmic_vusb33_ldo_reg = "/mt_pmic_regulator/ldo_regulators/ldo_vusb33";
		mt_pmic_vxo22_ldo_reg = "/mt_pmic_regulator/ldo_regulators/ldo_vxo22";
		mtkfb = "/mtkfb";
		nfc = "/nfc";
		odm = "/odm";
		otg_iddig = "/otg_iddig";
		pio = "/pinctrl@1000b000";
		pmic_clock_buffer_ctrl = "/pmic_clock_buffer_ctrl";
		reserved_memory = "/reserved-memory";
		rt9465_slave_chr = "/rt9465_slave_chr";
		sar = "/sar";
		sboard_id = "/sboard_id";
		scpsys = "/scpsys@10001000";
		sdtray_id = "/sdtray_id";
		sim1_hot_plug = "/sim1_hot_plug";
		smi_larb0 = "/smi_larb0@14003000";
		smi_larb1 = "/smi_larb1@17010000";
		smi_larb2 = "/smi_larb2@15001000";
		spi0 = "/spi@1100a000";
		spi1 = "/spi@11010000";
		spi2 = "/spi@11012000";
		syscfg_pctl_a = "/syscfg_pctl_a@10005000";
		syscfg_pctl_bl = "/syscfg_pctl_bl@10002600";
		syscfg_pctl_bm = "/syscfg_pctl_bm@10002800";
		syscfg_pctl_lb = "/syscfg_pctl_lb@10002400";
		syscfg_pctl_lm = "/syscfg_pctl_lm@10002200";
		syscfg_pctl_lt = "/syscfg_pctl_lt@10002000";
		syscfg_pctl_rb = "/syscfg_pctl_rb@10002a00";
		syscfg_pctl_rt = "/syscfg_pctl_bl@10002c00";
		sysirq = "/intpol-controller@0x10200620";
		topckgen = "/topckgen@10000000";
		touch = "/touch";
		venc = "/venc@17020000";
		venc_global_con = "/venc_global_con@17000000";
	};

	accdet {
		compatible = "mediatek,pmic-accdet";
		linux,phandle = <0x3d>;
		phandle = <0x3d>;
	};

	aes_top0@10016000 {
		compatible = "mediatek,aes_top0";
		reg = <0x0 0x10016000 0x0 0x1000>;
	};

	als_ps@0 {
		compatible = "mediatek,als_ps";
		linux,phandle = <0x5d>;
		phandle = <0x5d>;
	};

	amms_control {
		compatible = "mediatek,amms";
		interrupts = <0x0 0x7b 0x1>;
	};

	ap_ccif0@10209000 {
		compatible = "mediatek,ap_ccif0";
		interrupts = <0x0 0x94 0x8>;
		reg = <0x0 0x10209000 0x0 0x1000>;
	};

	ap_ccif1@1020b000 {
		compatible = "mediatek,ap_ccif1";
		interrupts = <0x0 0x96 0x8>;
		reg = <0x0 0x1020b000 0x0 0x1000>;
	};

	ap_dma@11000000 {
		compatible = "mediatek,ap_dma";
		interrupts = <0x0 0x52 0x8>;
		reg = <0x0 0x11000000 0x0 0x1000>;
	};

	apcldmain@1021b000 {
		compatible = "mediatek,apcldmain";
		reg = <0x0 0x1021b000 0x0 0x0>;
	};

	apcldmain@1021b100 {
		compatible = "mediatek,apcldmain";
		reg = <0x0 0x1021b100 0x0 0x0>;
	};

	apcldmain_ao@10014000 {
		compatible = "mediatek,apcldmain_ao";
		reg = <0x0 0x10014000 0x0 0x400>;
	};

	apcldmamisc@1021b800 {
		compatible = "mediatek,apcldmamisc";
		interrupts = <0x0 0xa5 0x4>;
		reg = <0x0 0x1021b800 0x0 0x0>;
	};

	apcldmamisc@1021b900 {
		compatible = "mediatek,apcldmamisc";
		reg = <0x0 0x1021b900 0x0 0x400>;
	};

	apcldmamisc_ao@10014800 {
		compatible = "mediatek,apcldmamisc_ao";
		reg = <0x0 0x10014800 0x0 0x400>;
	};

	apcldmamisc_ao@10014c00 {
		compatible = "mediatek,apcldmamisc_ao";
		reg = <0x0 0x10014c00 0x0 0x400>;
	};

	apcldmaout@1021b400 {
		compatible = "mediatek,apcldmaout";
		reg = <0x0 0x1021b400 0x0 0x0>;
	};

	apcldmaout@1021b500 {
		compatible = "mediatek,apcldmaout";
		reg = <0x0 0x1021b500 0x0 0x0>;
	};

	apcldmaout_ao@10014400 {
		compatible = "mediatek,apcldmaout_ao";
		reg = <0x0 0x10014400 0x0 0x400>;
	};

	apmixed@1000c000 {
		#clock-cells = <0x1>;
		compatible = "mediatek,apmixed", "mediatek,apmixedsys", "syscon";
		linux,phandle = <0x32>;
		phandle = <0x32>;
		reg = <0x0 0x1000c000 0x0 0x1000>;
	};

	apuart0@11002000 {
		cell-index = <0x0>;
		clock-div = <0x1>;
		clock-frequency = <0x18cba80>;
		clock-names = "uart0-main", "uart-apdma";
		clocks = <0x19 0x14 0x19 0x28>;
		compatible = "mediatek,mtk-uart";
		interrupts = <0x0 0x5b 0x8 0x0 0x68 0x8 0x0 0x69 0x8>;
		linux,phandle = <0x40>;
		phandle = <0x40>;
		reg = <0x0 0x11002000 0x0 0x1000 0x0 0x11000400 0x0 0x80 0x0 0x11000480 0x0 0x80>;
	};

	apuart1@11003000 {
		cell-index = <0x1>;
		clock-div = <0x1>;
		clock-frequency = <0x18cba80>;
		clock-names = "uart1-main";
		clocks = <0x19 0x15>;
		compatible = "mediatek,mtk-uart";
		interrupts = <0x0 0x5c 0x8 0x0 0x6a 0x8 0x0 0x6b 0x8>;
		linux,phandle = <0x41>;
		phandle = <0x41>;
		reg = <0x0 0x11003000 0x0 0x1000 0x0 0x11000500 0x0 0x80 0x0 0x11000580 0x0 0x80>;
	};

	apxgpt@10008000 {
		clocks = <0x18>;
		compatible = "mediatek,apxgpt";
		interrupts = <0x0 0xa6 0x8>;
		reg = <0x0 0x10008000 0x0 0x1000>;
	};

	atf_logger {
		compatible = "mediatek,atf_logger";
		interrupts = <0x0 0xf1 0x1>;
	};

	audio@11220000 {
		#clock-cells = <0x1>;
		compatible = "mediatek,audio", "syscon";
		linux,phandle = <0x31>;
		phandle = <0x31>;
		reg = <0x0 0x11220000 0x0 0x1000>;
	};

	audio_sram@11221000 {
		compatible = "mediatek,audio_sram";
		reg = <0x0 0x11221000 0x0 0x9000>;
	};

	auxadc@11001000 {
		clock-names = "auxadc-main";
		clocks = <0x19 0x22>;
		compatible = "mediatek,auxadc";
		interrupts = <0x0 0x4a 0x2>;
		linux,phandle = <0x3f>;
		phandle = <0x3f>;
		reg = <0x0 0x11001000 0x0 0x1000>;
	};

	bat_gm30 {
		CAR_TUNE_VALUE = <0x64>;
		DIFFERENCE_FULLOCV_ITH = <0xc8>;
		EMBEDDED_SEL = <0x0>;
		FG_METER_RESISTANCE = <0x4b>;
		KEEP_100_PERCENT = <0x2>;
		PMIC_SHUTDOWN_CURRENT = <0x14>;
		Q_MAX_BATTERY_CAPACITY = <0xb68>;
		Q_MAX_SYS_VOLTAGE_BAT0 = <0xd48>;
		Q_MAX_SYS_VOLTAGE_BAT1 = <0xd48>;
		Q_MAX_SYS_VOLTAGE_BAT2 = <0xd48>;
		Q_MAX_SYS_VOLTAGE_BAT3 = <0xd48>;
		R_FG_VALUE = <0xa>;
		SHUTDOWN_1_TIME = <0x3c>;
		TEMPERATURE_T0 = <0x32>;
		TEMPERATURE_T1 = <0x19>;
		TEMPERATURE_T2 = <0xa>;
		TEMPERATURE_T3 = <0x0>;
		TEMPERATURE_T4 = <0xfffffff6>;
		battery0_profile_t0 = <0x0 0xaae6 0x44c 0x138 0xaa4a 0x44c 0x271 0xa9b9 0x44c 0x3a9 0xa930 0x44c 0x4e1 0xa8ac 0x44c 0x61a 0xa82f 0x44c 0x752 0xa7b2 0x44c 0x88a 0xa73a 0x458 0x9c3 0xa6c3 0x465 0xafb 0xa646 0x466 0xc33 0xa5d1 0x479 0xd6c 0xa556 0x46f 0xea4 0xa4dd 0x465 0xfdc 0xa467 0x469 0x1115 0xa3f2 0x47c 0x124d 0xa37d 0x47e 0x1385 0xa308 0x47e 0x14bd 0xa293 0x47e 0x15f6 0xa21e 0x47f 0x172e 0xa1b1 0x493 0x1866 0xa144 0x4a6 0x199f 0xa0d6 0x4b0 0x1ad7 0xa069 0x4b0 0x1c0f 0x9ffc 0x4b0 0x1d48 0x9f8e 0x4b0 0x1e80 0x9f26 0x4bd 0x1fb8 0x9ec1 0x4c9 0x20f1 0x9e5b 0x4c9 0x2229 0x9df6 0x4c9 0x2361 0x9d95 0x4d9 0x249a 0x9d36 0x4ed 0x25d2 0x9cd8 0x4fb 0x270a 0x9c7b 0x4fb 0x2843 0x9c25 0x50f 0x297b 0x9bcf 0x522 0x2ab3 0x9b79 0x52d 0x2bec 0x9b23 0x52d 0x2d24 0x9acd 0x52d 0x2e5c 0x9a77 0x53e 0x2f95 0x9a22 0x546 0x30cd 0x99c7 0x540 0x3205 0x9961 0x52b 0x333e 0x98f3 0x504 0x3476 0x9880 0x4ce 0x35ae 0x9813 0x4a6 0x36e7 0x97b2 0x493 0x381f 0x9764 0x47f 0x3957 0x971d 0x47e 0x3a90 0x96dc 0x47e 0x3bc8 0x969d 0x47e 0x3d00 0x965f 0x47e 0x3e38 0x9629 0x47e 0x3f71 0x95f8 0x48e 0x40a9 0x95c5 0x48d 0x41e1 0x9593 0x483 0x431a 0x956c 0x496 0x4452 0x953d 0x497 0x458a 0x9513 0x4a4 0x46c3 0x94ec 0x4b0 0x47fb 0x94c5 0x4b2 0x4933 0x949e 0x4c6 0x4a6c 0x9477 0x4b9 0x4ba4 0x9455 0x4bb 0x4cdc 0x9435 0x4ce 0x4e15 0x9416 0x4e2 0x4f4d 0x93f7 0x4f5 0x5085 0x93d8 0x4fb 0x51be 0x93b8 0x503 0x52f6 0x9398 0x514 0x542e 0x9371 0x514 0x5567 0x9328 0x4d0 0x569f 0x92da 0x4a4 0x57d7 0x9293 0x49d 0x5910 0x925d 0x4b1 0x5a48 0x922e 0x4c4 0x5b80 0x91f9 0x4ba 0x5cb9 0x91ca 0x4b9 0x5df1 0x91a3 0x4c9 0x5f29 0x917c 0x4c9 0x6062 0x9155 0x4c9 0x619a 0x912e 0x4c9 0x62d2 0x9101 0x4d0 0x640b 0x90ca 0x4e1 0x6543 0x908b 0x4cd 0x667b 0x904d 0x4c9 0x67b3 0x900b 0x4c9 0x68ec 0x8fc3 0x4c9 0x6a24 0x8f74 0x4c9 0x6b5c 0x8f3b 0x4c9 0x6c95 0x8f14 0x4d7 0x6dcd 0x8eef 0x4ea 0x6f05 0x8ebe 0x500 0x703e 0x8e7f 0x527 0x7176 0x8e0c 0x54e 0x72ae 0x8d16 0x554 0x73e7 0x8b95 0x557 0x751f 0x8997 0x592 0x7657 0x86d8 0x5e0 0x7790 0x8309 0x6ae 0x78c8 0x7f12 0x52d>;
		battery0_profile_t0_num = <0x64>;
		battery0_profile_t1 = <0x0 0xaa50 0x62c 0x138 0xa9ac 0x628 0x271 0xa924 0x643 0x3a9 0xa8a4 0x659 0x4e1 0xa820 0x659 0x61a 0xa7a3 0x659 0x752 0xa72d 0x66a 0x88a 0xa6b3 0x672 0x9c3 0xa639 0x678 0xafb 0xa5c4 0x68b 0xc33 0xa547 0x68b 0xd6c 0xa4d0 0x69a 0xea4 0xa45b 0x6a4 0xfdc 0xa3e5 0x6a8 0x1115 0xa370 0x6bb 0x124d 0xa2fb 0x6bd 0x1385 0xa286 0x6c9 0x14bd 0xa214 0x6dd 0x15f6 0xa1a6 0x6ee 0x172e 0xa131 0x6da 0x1866 0xa0c2 0x6e5 0x199f 0xa054 0x6f9 0x1ad7 0x9fe9 0x708 0x1c0f 0x9f83 0x708 0x1d48 0x9f1e 0x72d 0x1e80 0x9eb8 0x73a 0x1fb8 0x9e53 0x742 0x20f1 0x9dee 0x755 0x2229 0x9d90 0x769 0x2361 0x9d31 0x76c 0x249a 0x9cd2 0x76c 0x25d2 0x9c77 0x772 0x270a 0x9c21 0x785 0x2843 0x9bc3 0x785 0x297b 0x9b6b 0x793 0x2ab3 0x9b15 0x79e 0x2bec 0x9abe 0x79e 0x2d24 0x9a60 0x79e 0x2e5c 0x99fc 0x77b 0x2f95 0x9996 0x760 0x30cd 0x992e 0x740 0x3205 0x98c1 0x706 0x333e 0x985c 0x6df 0x3476 0x97fc 0x6b8 0x35ae 0x97a6 0x69a 0x36e7 0x9758 0x68b 0x381f 0x970a 0x68b 0x3957 0x96ca 0x68b 0x3a90 0x9691 0x68b 0x3bc8 0x965a 0x68b 0x3d00 0x9623 0x68b 0x3e38 0x95ed 0x68b 0x3f71 0x95bc 0x69b 0x40a9 0x958e 0x6a4 0x41e1 0x955f 0x6a4 0x431a 0x9530 0x6a4 0x4452 0x9508 0x6b7 0x458a 0x94e1 0x6bd 0x46c3 0x94be 0x6c5 0x47fb 0x949e 0x6d8 0x4933 0x947f 0x6ec 0x4a6c 0x9460 0x6ff 0x4ba4 0x9441 0x713 0x4cdc 0x9421 0x721 0x4e15 0x9402 0x721 0x4f4d 0x93e3 0x721 0x5085 0x93c4 0x721 0x51be 0x93a4 0x721 0x52f6 0x9385 0x721 0x542e 0x9366 0x721 0x5567 0x9339 0x710 0x569f 0x930a 0x6fc 0x57d7 0x92db 0x6ef 0x5910 0x92ad 0x6ef 0x5a48 0x927e 0x6ef 0x5b80 0x9255 0x6fe 0x5cb9 0x922e 0x708 0x5df1 0x9207 0x708 0x5f29 0x91e0 0x708 0x6062 0x91b9 0x71a 0x619a 0x9188 0x72d 0x62d2 0x914e 0x73a 0x640b 0x9110 0x73b 0x6543 0x90d1 0x74f 0x667b 0x908d 0x753 0x67b3 0x903f 0x753 0x68ec 0x8fec 0x753 0x6a24 0x8fa6 0x753 0x6b5c 0x8f7c 0x78c 0x6c95 0x8f4f 0x7c7 0x6dcd 0x8f1a 0x811 0x6f05 0x8ed6 0x878 0x703e 0x8e68 0x901 0x7176 0x8d76 0x947 0x72ae 0x8be7 0x9a3 0x73e7 0x89ba 0xa51 0x751f 0x8700 0xb8b 0x7657 0x82ec 0xd76 0x7790 0x805c 0x866 0x78c8 0x805c 0x866>;
		battery0_profile_t1_num = <0x64>;
		battery0_profile_t2 = <0x0 0xa97e 0x94c 0x138 0xa8c3 0x948 0x271 0xa823 0x971 0x3a9 0xa796 0x99b 0x4e1 0xa711 0x9ae 0x61a 0xa68c 0x9c2 0x752 0xa60e 0x9e6 0x88a 0xa596 0xa0d 0x9c3 0xa51f 0xa28 0xafb 0xa4a2 0xa29 0xc33 0xa425 0xa3c 0xd6c 0xa3ae 0xa50 0xea4 0xa339 0xa63 0xfdc 0xa2c3 0xa77 0x1115 0xa24e 0xa8a 0x124d 0xa1d9 0xa9e 0x1385 0xa169 0xab1 0x14bd 0xa0fc 0xac5 0x15f6 0xa08e 0xad8 0x172e 0xa021 0xaec 0x1866 0x9fb4 0xaf0 0x199f 0x9f46 0xaf0 0x1ad7 0x9edb 0xaf9 0x1c0f 0x9e75 0xb20 0x1d48 0x9e17 0xb34 0x1e80 0x9db4 0xb3b 0x1fb8 0x9d52 0xb43 0x20f1 0x9cf4 0xb56 0x2229 0x9c96 0xb6a 0x2361 0x9c37 0xb6d 0x249a 0x9bd8 0xb78 0x25d2 0x9b7d 0xb86 0x270a 0x9b27 0xb86 0x2843 0x9ac9 0xb86 0x297b 0x9a6b 0xb78 0x2ab3 0x9a0a 0xb5b 0x2bec 0x99a5 0xb34 0x2d24 0x993f 0xb0d 0x2e5c 0x98d3 0xae6 0x2f95 0x986a 0xabf 0x30cd 0x9807 0xa98 0x3205 0x97aa 0xa74 0x333e 0x975c 0xa87 0x3476 0x9714 0xa8c 0x35ae 0x96ce 0xa8c 0x36e7 0x968b 0xa90 0x381f 0x9654 0xaa4 0x3957 0x961d 0xab7 0x3a90 0x95e7 0xabe 0x3bc8 0x95b3 0xac5 0x3d00 0x9584 0xad7 0x3e38 0x9555 0xad7 0x3f71 0x952d 0xaf6 0x40a9 0x9506 0xb13 0x41e1 0x94df 0xb27 0x431a 0x94b8 0xb3a 0x4452 0x9490 0xb3b 0x458a 0x946f 0xb56 0x46c3 0x9450 0xb75 0x47fb 0x942f 0xb86 0x4933 0x9408 0xb86 0x4a6c 0x93ee 0xb96 0x4ba4 0x93d7 0xbc0 0x4cdc 0x93bd 0xbea 0x4e15 0x939e 0xbea 0x4f4d 0x9387 0xbea 0x5085 0x936f 0xbf8 0x51be 0x9354 0xc0b 0x52f6 0x9335 0xc19 0x542e 0x9316 0xc05 0x5567 0x92f0 0xc14 0x569f 0x92c4 0xc1c 0x57d7 0x9295 0xc1c 0x5910 0x9267 0xc1d 0x5a48 0x9240 0xc30 0x5b80 0x9219 0xc52 0x5cb9 0x91ea 0xc79 0x5df1 0x91b2 0xca0 0x5f29 0x9174 0xcc7 0x6062 0x912e 0xcdd 0x619a 0x90ed 0xd15 0x62d2 0x90a9 0xd71 0x640b 0x9059 0xde1 0x6543 0x8ff4 0xe08 0x667b 0x8f9b 0xe7b 0x67b3 0x8f51 0xf21 0x68ec 0x8f12 0x1003 0x6a24 0x8ed4 0x114f 0x6b5c 0x8e85 0x1327 0x6c95 0x8e10 0x1594 0x6dcd 0x8d41 0x18c0 0x6f05 0x8bec 0x1cb8 0x703e 0x89d5 0x2014 0x7176 0x874c 0x19eb 0x72ae 0x8520 0x1469 0x73e7 0x8520 0x1469 0x751f 0x8520 0x1469 0x7657 0x8520 0x1469 0x7790 0x8520 0x1469 0x78c8 0x8520 0x1469>;
		battery0_profile_t2_num = <0x64>;
		battery0_profile_t3 = <0x0 0xa83e 0xec4 0x138 0xa754 0xec0 0x271 0xa69c 0xf21 0x3a9 0xa5ff 0xf88 0x4e1 0xa56d 0xfc2 0x61a 0xa4e8 0xffd 0x752 0xa464 0x1037 0x88a 0xa3e3 0x1072 0x9c3 0xa367 0x10a0 0xafb 0xa2ea 0x10b4 0xc33 0xa275 0x10c7 0xd6c 0xa200 0x10e9 0xea4 0xa18b 0x1110 0xfdc 0xa115 0x1130 0x1115 0xa0a0 0x1130 0x124d 0xa032 0x1154 0x1385 0x9fc5 0x117b 0x14bd 0x9f5a 0x11a2 0x15f6 0x9ef4 0x11c6 0x172e 0x9e87 0x11c6 0x1866 0x9e20 0x11d5 0x199f 0x9dba 0x11e9 0x1ad7 0x9d55 0x1201 0x1c0f 0x9cef 0x1228 0x1d48 0x9c8a 0x123c 0x1e80 0x9c2f 0x1250 0x1fb8 0x9bd6 0x1264 0x20f1 0x9b77 0x1275 0x2229 0x9b12 0x1275 0x2361 0x9ab1 0x1265 0x249a 0x9a52 0x1267 0x25d2 0x99f0 0x1264 0x270a 0x9983 0x122a 0x2843 0x991d 0x122a 0x297b 0x98b8 0x120d 0x2ab3 0x9852 0x11f8 0x2bec 0x97ef 0x11fb 0x2d24 0x9799 0x120f 0x2e5c 0x974a 0x1211 0x2f95 0x96fc 0x1211 0x30cd 0x96b3 0x1224 0x3205 0x9675 0x125d 0x333e 0x9636 0x1270 0x3476 0x95fe 0x1275 0x35ae 0x95c7 0x129b 0x36e7 0x9592 0x12dd 0x381f 0x9563 0x12f1 0x3957 0x9535 0x1316 0x3a90 0x9506 0x133d 0x3bc8 0x94da 0x135d 0x3d00 0x94b3 0x1374 0x3e38 0x948c 0x13ae 0x3f71 0x9465 0x13ba 0x40a9 0x9442 0x13e3 0x41e1 0x9422 0x141e 0x431a 0x9403 0x141e 0x4452 0x93e4 0x1456 0x458a 0x93ca 0x1484 0x46c3 0x93b3 0x14a3 0x47fb 0x939b 0x14bd 0x4933 0x9384 0x150b 0x4a6c 0x936c 0x1528 0x4ba4 0x9359 0x1552 0x4cdc 0x9348 0x1592 0x4e15 0x9330 0x15e0 0x4f4d 0x9311 0x1607 0x5085 0x92ec 0x1612 0x51be 0x92c2 0x162b 0x52f6 0x9294 0x166f 0x542e 0x926d 0x16e4 0x5567 0x923f 0x1748 0x569f 0x920c 0x17aa 0x57d7 0x91d3 0x1811 0x5910 0x9194 0x1888 0x5a48 0x914e 0x1938 0x5b80 0x9101 0x1a14 0x5cb9 0x90b3 0x1b10 0x5df1 0x9062 0x1c2d 0x5f29 0x9005 0x1d78 0x6062 0x8f99 0x1f0b 0x619a 0x8f30 0x211f 0x62d2 0x8ed0 0x23db 0x640b 0x8e7b 0x2750 0x6543 0x8e2f 0x2b10 0x667b 0x8dee 0x2a6b 0x67b3 0x8da2 0x29ac 0x68ec 0x8d29 0x288b 0x6a24 0x8c43 0x2640 0x6b5c 0x8bba 0x24d1 0x6c95 0x8bba 0x24d1 0x6dcd 0x8bba 0x24d1 0x6f05 0x8bba 0x24d1 0x703e 0x8bba 0x24d1 0x7176 0x8bba 0x24d1 0x72ae 0x8bba 0x24d1 0x73e7 0x8bba 0x24d1 0x751f 0x8bba 0x24d1 0x7657 0x8bba 0x24d1 0x7790 0x8bba 0x24d1 0x78c8 0x8bba 0x24d1>;
		battery0_profile_t3_num = <0x64>;
		battery0_profile_t4 = <0x0 0xa564 0x1b12 0x138 0xa42c 0x1b0e 0x271 0xa348 0x1c26 0x3a9 0xa296 0x1d4e 0x4e1 0xa1fc 0x1dfb 0x61a 0xa16f 0x1e97 0x752 0xa0f0 0x1eee 0x88a 0xa06f 0x1f25 0x9c3 0x9fef 0x1f5f 0xafb 0x9f7a 0x1fc0 0xc33 0x9f0d 0x2022 0xd6c 0x9e9a 0x203a 0xea4 0x9e25 0x2056 0xfdc 0x9db1 0x2090 0x1115 0x9d44 0x20cb 0x124d 0x9cd6 0x2117 0x1385 0x9c6e 0x2165 0x14bd 0x9c08 0x2191 0x15f6 0x9ba3 0x2184 0x172e 0x9b3d 0x21d3 0x1866 0x9ad8 0x21d4 0x199f 0x9a76 0x21d4 0x1ad7 0x9a17 0x21f5 0x1c0f 0x99b1 0x2243 0x1d48 0x994c 0x2235 0x1e80 0x98e6 0x222e 0x1fb8 0x9884 0x222e 0x20f1 0x9826 0x2230 0x2229 0x97c8 0x2244 0x2361 0x9771 0x2267 0x249a 0x971b 0x2284 0x25d2 0x96ca 0x22b1 0x270a 0x9683 0x2326 0x2843 0x963d 0x234e 0x297b 0x95fc 0x2375 0x2ab3 0x95c1 0x239c 0x2bec 0x958a 0x23c3 0x2d24 0x9554 0x23ea 0x2e5c 0x9524 0x2433 0x2f95 0x94f5 0x248c 0x30cd 0x94c8 0x24d1 0x3205 0x94a1 0x24d3 0x333e 0x947a 0x2548 0x3476 0x9459 0x2584 0x35ae 0x9436 0x25b4 0x36e7 0x9412 0x25f8 0x381f 0x93fa 0x266e 0x3957 0x93dc 0x269d 0x3a90 0x93c2 0x26c4 0x3bc8 0x93aa 0x2717 0x3d00 0x9394 0x27bf 0x3e38 0x937c 0x27d3 0x3f71 0x9365 0x2812 0x40a9 0x934a 0x2869 0x41e1 0x932c 0x28d8 0x431a 0x9314 0x2988 0x4452 0x92f6 0x2a03 0x458a 0x92d2 0x2a9c 0x46c3 0x92ab 0x2b52 0x47fb 0x9283 0x2c17 0x4933 0x9255 0x2ced 0x4a6c 0x9226 0x2e01 0x4ba4 0x91ef 0x2f12 0x4cdc 0x91b1 0x3021 0x4e15 0x9172 0x316c 0x4f4d 0x9139 0x325f 0x5085 0x9105 0x3211 0x51be 0x90c8 0x3175 0x52f6 0x908f 0x30e9 0x542e 0x904e 0x3045 0x5567 0x900a 0x2fa1 0x569f 0x8fbb 0x2eed 0x57d7 0x8f65 0x2e08 0x5910 0x8f14 0x2d70 0x5a48 0x8f0c 0x2d37 0x5b80 0x8f0c 0x2d37 0x5cb9 0x8f0c 0x2d37 0x5df1 0x8f0c 0x2d37 0x5f29 0x8f0c 0x2d37 0x6062 0x8f0c 0x2d37 0x619a 0x8f0c 0x2d37 0x62d2 0x8f0c 0x2d37 0x640b 0x8f0c 0x2d37 0x6543 0x8f0c 0x2d37 0x667b 0x8f0c 0x2d37 0x67b3 0x8f0c 0x2d37 0x68ec 0x8f0c 0x2d37 0x6a24 0x8f0c 0x2d37 0x6b5c 0x8f0c 0x2d37 0x6c95 0x8f0c 0x2d37 0x6dcd 0x8f0c 0x2d37 0x6f05 0x8f0c 0x2d37 0x703e 0x8f0c 0x2d37 0x7176 0x8f0c 0x2d37 0x72ae 0x8f0c 0x2d37 0x73e7 0x8f0c 0x2d37 0x751f 0x8f0c 0x2d37 0x7657 0x8f0c 0x2d37 0x7790 0x8f0c 0x2d37 0x78c8 0x8f0c 0x2d37>;
		battery0_profile_t4_num = <0x64>;
		battery1_profile_t0 = <0x0 0xaadc 0x3d4 0x12e 0xaa54 0x3d0 0x25c 0xa9d1 0x3cf 0x38a 0xa956 0x3cf 0x4b8 0xa8e5 0x3cf 0x5e6 0xa864 0x3bc 0x714 0xa7e9 0x3b6 0x841 0xa773 0x3bd 0x96f 0xa702 0x3cf 0xa9d 0xa689 0x3cf 0xbcb 0xa610 0x3cf 0xcf9 0xa59b 0x3d7 0xe27 0xa529 0x3e7 0xf55 0xa4b0 0x3d4 0x1083 0xa43d 0x3dd 0x11b1 0xa3c8 0x3e8 0x12df 0xa350 0x3ea 0x140d 0xa2df 0x3fd 0x153b 0xa26e 0x401 0x1668 0xa1fd 0x401 0x1796 0xa18c 0x401 0x18c4 0xa11a 0x401 0x19f2 0xa0af 0x410 0x1b20 0xa046 0x41a 0x1c4e 0x9fdc 0x41d 0x1d7c 0x9f72 0x430 0x1eaa 0x9f0f 0x443 0x1fd8 0x9ea9 0x44c 0x2106 0x9e42 0x44f 0x2234 0x9de7 0x462 0x2362 0x9d84 0x476 0x248f 0x9d21 0x47e 0x25bd 0x9cc1 0x482 0x26eb 0x9c66 0x495 0x2819 0x9c12 0x4a8 0x2947 0x9bbb 0x4b0 0x2a75 0x9b62 0x4b5 0x2ba3 0x9b0f 0x4c8 0x2cd1 0x9abc 0x4db 0x2dff 0x9a6e 0x505 0x2f2d 0x9a1a 0x522 0x305b 0x99b0 0x4fc 0x3189 0x9929 0x4a0 0x32b7 0x98a6 0x44e 0x33e4 0x982f 0x40e 0x3512 0x97cd 0x3e8 0x3640 0x9781 0x3d5 0x376e 0x973b 0x3cf 0x389c 0x96fa 0x3cf 0x39ca 0x96bd 0x3cf 0x3af8 0x9681 0x3cf 0x3c26 0x964a 0x3cf 0x3d54 0x9618 0x3d6 0x3e82 0x95ea 0x3e8 0x3fb0 0x95b5 0x3e8 0x40de 0x9586 0x3e8 0x420b 0x9558 0x3e8 0x4339 0x952c 0x3e9 0x4467 0x9506 0x3fc 0x4595 0x94e0 0x40f 0x46c3 0x94ba 0x41a 0x47f1 0x9495 0x41d 0x491f 0x9477 0x443 0x4a4d 0x9459 0x45a 0x4b7b 0x943b 0x465 0x4ca9 0x941d 0x467 0x4dd7 0x93fe 0x47a 0x4f05 0x93e0 0x47e 0x5033 0x93be 0x47e 0x5160 0x9396 0x476 0x528e 0x9359 0x43d 0x53bc 0x930a 0x405 0x54ea 0x92c6 0x3f1 0x5618 0x9292 0x401 0x5746 0x9265 0x401 0x5874 0x9238 0x401 0x59a2 0x920b 0x401 0x5ad0 0x91df 0x401 0x5bfe 0x91b9 0x401 0x5d2c 0x919a 0x411 0x5e5a 0x9178 0x41a 0x5f87 0x914f 0x41a 0x60b5 0x911a 0x41a 0x61e3 0x90d7 0x409 0x6311 0x909c 0x40c 0x643f 0x9064 0x41a 0x656d 0x9020 0x41a 0x669b 0x8fd5 0x3e6 0x67c9 0x8fb2 0x3e5 0x68f7 0x8fa8 0x406 0x6a25 0x8f99 0x419 0x6b53 0x8f91 0x451 0x6c81 0x8f75 0x47e 0x6dae 0x8f26 0x48b 0x6edc 0x8e7f 0x465 0x700a 0x8cd9 0x465 0x7138 0x8abd 0x4a5 0x7266 0x87f1 0x51e 0x7394 0x843a 0x5cd 0x74c2 0x7e68 0x384>;
		battery1_profile_t0_num = <0x64>;
		battery1_profile_t1 = <0x0 0xaa3c 0x5fa 0x12e 0xa9ad 0x5f6 0x25c 0xa92c 0x602 0x38a 0xa8b1 0x60e 0x4b8 0xa831 0x60e 0x5e6 0xa7b8 0x60e 0x714 0xa73f 0x60e 0x841 0xa6c9 0x615 0x96f 0xa658 0x627 0xa9d 0xa5df 0x627 0xbcb 0xa566 0x627 0xcf9 0xa4f1 0x62f 0xe27 0xa47f 0x63f 0xf55 0xa406 0x62c 0x1083 0xa393 0x627 0x11b1 0xa325 0x637 0x12df 0xa2ba 0x659 0x140d 0xa241 0x659 0x153b 0xa1d4 0x668 0x1668 0xa167 0x67b 0x1796 0xa0f7 0x68d 0x18c4 0xa08d 0x6a0 0x19f2 0xa01d 0x695 0x1b20 0x9fb3 0x694 0x1c4e 0x9f53 0x6aa 0x1d7c 0x9f00 0x6cf 0x1eaa 0x9ea1 0x6f5 0x1fd8 0x9e37 0x711 0x2106 0x9dc6 0x721 0x2234 0x9d55 0x721 0x2362 0x9ce8 0x721 0x248f 0x9c85 0x736 0x25bd 0x9c2b 0x753 0x26eb 0x9bd0 0x753 0x2819 0x9b7c 0x753 0x2947 0x9b2e 0x75e 0x2a75 0x9ae2 0x771 0x2ba3 0x9a97 0x784 0x2cd1 0x9a36 0x762 0x2dff 0x99c6 0x730 0x2f2d 0x9949 0x6e2 0x305b 0x98c1 0x65e 0x3189 0x984f 0x610 0x32b7 0x97ec 0x5dd 0x33e4 0x9799 0x5c3 0x3512 0x9755 0x5c3 0x3640 0x9711 0x5b0 0x376e 0x96d2 0x5aa 0x389c 0x9698 0x5aa 0x39ca 0x9663 0x5aa 0x3af8 0x962e 0x5bd 0x3c26 0x95ff 0x5d0 0x3d54 0x95cf 0x5d5 0x3e82 0x959b 0x5c4 0x3fb0 0x9575 0x5ea 0x40de 0x954a 0x5e8 0x420b 0x951f 0x5e3 0x4339 0x94fa 0x5f7 0x4467 0x94dc 0x61d 0x4595 0x94b8 0x627 0x46c3 0x9495 0x62f 0x47f1 0x9477 0x640 0x491f 0x9459 0x640 0x4a4d 0x943b 0x64e 0x4b7b 0x941d 0x659 0x4ca9 0x93ff 0x657 0x4dd7 0x93e0 0x644 0x4f05 0x93c2 0x64f 0x5033 0x93a0 0x647 0x5160 0x937b 0x627 0x528e 0x9355 0x627 0x53bc 0x9329 0x608 0x54ea 0x92ff 0x5f5 0x5618 0x92da 0x5f5 0x5746 0x92b4 0x5f5 0x5874 0x9288 0x5e5 0x59a2 0x9262 0x5dc 0x5ad0 0x9244 0x5e3 0x5bfe 0x9226 0x609 0x5d2c 0x91fb 0x60e 0x5e5a 0x91c5 0x60e 0x5f87 0x918b 0x60e 0x60b5 0x9156 0x60e 0x61e3 0x9121 0x630 0x6311 0x90db 0x635 0x643f 0x908d 0x622 0x656d 0x9051 0x610 0x669b 0x903e 0x631 0x67c9 0x902f 0x656 0x68f7 0x9020 0x686 0x6a25 0x9011 0x6d2 0x6b53 0x8ff3 0x731 0x6c81 0x8f72 0x747 0x6dae 0x8e64 0x73a 0x6edc 0x8c9f 0x73a 0x700a 0x8a0e 0x7be 0x7138 0x8660 0x8cf 0x7266 0x8173 0x972 0x7394 0x7f8a 0x672 0x74c2 0x7f8a 0x672>;
		battery1_profile_t1_num = <0x64>;
		battery1_profile_t2 = <0x0 0xa8ac 0xba4 0x12e 0xa7d9 0xba0 0x25c 0xa733 0xbc5 0x38a 0xa6a9 0xbf7 0x4b8 0xa629 0xc1c 0x5e6 0xa5a8 0xc09 0x714 0xa533 0xc1d 0x841 0xa4bf 0xc35 0x96f 0xa446 0xc36 0xa9d 0xa3d5 0xc49 0xbcb 0xa364 0xc4e 0xcf9 0xa2f0 0xc4e 0xe27 0xa278 0xc51 0xf55 0xa20e 0xc77 0x1083 0xa19f 0xc80 0x11b1 0xa12e 0xc88 0x12df 0xa0bd 0xc9d 0x140d 0xa054 0xcc3 0x153b 0x9ff0 0xcda 0x1668 0x9f91 0xcf5 0x1796 0x9f37 0xd20 0x18c4 0x9ee4 0xd6b 0x19f2 0x9e7f 0xd98 0x1b20 0x9e04 0xd9a 0x1c4e 0x9d74 0xd74 0x1d7c 0x9ce5 0xd4f 0x1eaa 0x9c6e 0xd48 0x1fd8 0x9c0c 0xd5b 0x2106 0x9bbc 0xd84 0x2234 0x9b78 0xdbd 0x2362 0x9b25 0xda4 0x248f 0x9ad1 0xd93 0x25bd 0x9a80 0xd8f 0x26eb 0x9a35 0xd7c 0x2819 0x99c7 0xd35 0x2947 0x9951 0xcea 0x2a75 0x98d8 0xca3 0x2ba3 0x9860 0xc6b 0x2cd1 0x97fc 0xc20 0x2dff 0x97a3 0xbf7 0x2f2d 0x9754 0xbef 0x305b 0x9711 0xc02 0x3189 0x96d4 0xc03 0x32b7 0x9697 0xbf7 0x33e4 0x965d 0xbf0 0x3512 0x9629 0xc03 0x3640 0x95f4 0xc16 0x376e 0x95c4 0xc29 0x389c 0x9597 0xc42 0x39ca 0x9569 0xc67 0x3af8 0x953c 0xc7a 0x3c26 0x9514 0xc73 0x3d54 0x94ee 0xc6e 0x3e82 0x94c9 0xc82 0x3fb0 0x94ab 0xcbb 0x40de 0x9487 0xcd8 0x420b 0x9464 0xcf3 0x4339 0x9446 0xd15 0x4467 0x9428 0xd02 0x4595 0x940a 0xd0b 0x46c3 0x93ef 0xd26 0x47f1 0x93d7 0xd48 0x491f 0x93b9 0xd48 0x4a4d 0x93a6 0xd73 0x4b7b 0x9394 0xd93 0x4ca9 0x937d 0xd97 0x4dd7 0x9367 0xdbd 0x4f05 0x934a 0xde3 0x5033 0x932c 0xdee 0x5160 0x930d 0xde6 0x528e 0x92e7 0xe1f 0x53bc 0x92c1 0xe57 0x54ea 0x929b 0xe7d 0x5618 0x9276 0xe9d 0x5746 0x9250 0xefb 0x5874 0x9217 0xf3a 0x59a2 0x91db 0xf68 0x5ad0 0x919e 0xf95 0x5bfe 0x9162 0xfe1 0x5d2c 0x911f 0x105d 0x5e5a 0x90d3 0x10b9 0x5f87 0x908a 0x1112 0x60b5 0x9064 0x11e2 0x61e3 0x904c 0x127f 0x6311 0x9035 0x1340 0x643f 0x901f 0x144c 0x656d 0x9008 0x15d8 0x669b 0x8fb3 0x1731 0x67c9 0x8eb7 0x1879 0x68f7 0x8d10 0x1a06 0x6a25 0x8ac4 0x1c61 0x6b53 0x8799 0x1a97 0x6c81 0x8321 0xf6b 0x6dae 0x81f6 0xc80 0x6edc 0x81f6 0xc80 0x700a 0x81f6 0xc80 0x7138 0x81f6 0xc80 0x7266 0x81f6 0xc80 0x7394 0x81f6 0xc80 0x74c2 0x81f6 0xc80>;
		battery1_profile_t2_num = <0x64>;
		battery1_profile_t3 = <0x0 0xa960 0x10ea 0x12e 0xa8b2 0x10e6 0x25c 0xa80f 0x1125 0x38a 0xa761 0x1169 0x4b8 0xa690 0x117e 0x5e6 0xa4f8 0x1202 0x714 0xa3ea 0x1529 0x841 0xa333 0x1830 0x96f 0xa2ac 0x191d 0xa9d 0xa233 0x1968 0xbcb 0xa1c0 0x1998 0xcf9 0xa14c 0x1998 0xe27 0xa0d4 0x1964 0xf55 0xa06a 0x1964 0x1083 0xa00c 0x19c7 0x11b1 0x9fb1 0x1a33 0x12df 0x9f57 0x1a75 0x140d 0x9efc 0x1a62 0x153b 0x9e84 0x1a7b 0x1668 0x9dfa 0x1a99 0x1796 0x9d62 0x1aa4 0x18c4 0x9cc3 0x1a7e 0x19f2 0x9c43 0x1a4a 0x1b20 0x9bd2 0x1a1a 0x1c4e 0x9b6b 0x1a06 0x1d7c 0x9b18 0x1a51 0x1eaa 0x9abf 0x1a5e 0x1fd8 0x9a61 0x1a42 0x2106 0x99fd 0x1a13 0x2234 0x9994 0x1a13 0x2362 0x9921 0x19e1 0x248f 0x98b7 0x1993 0x25bd 0x9857 0x193e 0x26eb 0x97fc 0x1905 0x2819 0x97a8 0x1945 0x2947 0x975e 0x194e 0x2a75 0x971a 0x1937 0x2ba3 0x96d6 0x194a 0x2cd1 0x9699 0x194b 0x2dff 0x9662 0x1990 0x2f2d 0x962d 0x19ec 0x305b 0x95f8 0x1a12 0x3189 0x95c3 0x19ca 0x32b7 0x9593 0x1a0f 0x33e4 0x9566 0x1a5f 0x3512 0x9539 0x1a14 0x3640 0x9513 0x1a83 0x376e 0x94e8 0x1acf 0x389c 0x94c0 0x1ae1 0x39ca 0x94a1 0x1aab 0x3af8 0x947c 0x1b55 0x3c26 0x9456 0x1b56 0x3d54 0x9436 0x1b56 0x3e82 0x941f 0x1bd3 0x3fb0 0x9401 0x1b9a 0x40de 0x93ed 0x1be8 0x420b 0x93db 0x1c40 0x4339 0x93c5 0x1c58 0x4467 0x93ae 0x1cb6 0x4595 0x9397 0x1d3f 0x46c3 0x937d 0x1d8f 0x47f1 0x935f 0x1d8c 0x491f 0x9341 0x1e22 0x4a4d 0x9323 0x1e80 0x4b7b 0x9301 0x1ebb 0x4ca9 0x92dc 0x1ef8 0x4dd7 0x92b6 0x1fee 0x4f05 0x928a 0x205d 0x5033 0x9256 0x20b1 0x5160 0x921b 0x2117 0x528e 0x91e6 0x21ae 0x53bc 0x91ab 0x22b1 0x54ea 0x9167 0x2394 0x5618 0x911a 0x2438 0x5746 0x90c7 0x24bc 0x5874 0x9094 0x258f 0x59a2 0x906e 0x26ac 0x5ad0 0x9052 0x282f 0x5bfe 0x903b 0x2a78 0x5d2c 0x9017 0x2c2e 0x5e5a 0x8fe0 0x2ddc 0x5f87 0x8f70 0x2e24 0x60b5 0x8e66 0x2b96 0x61e3 0x8c91 0x2714 0x6311 0x8a17 0x20d2 0x643f 0x8728 0x197d 0x656d 0x8728 0x197d 0x669b 0x8728 0x197d 0x67c9 0x8728 0x197d 0x68f7 0x8728 0x197d 0x6a25 0x8728 0x197d 0x6b53 0x8728 0x197d 0x6c81 0x8728 0x197d 0x6dae 0x8728 0x197d 0x6edc 0x8728 0x197d 0x700a 0x8728 0x197d 0x7138 0x8728 0x197d 0x7266 0x8728 0x197d 0x7394 0x8728 0x197d 0x74c2 0x8728 0x197d>;
		battery1_profile_t3_num = <0x64>;
		battery1_profile_t4 = <0x0 0xa708 0x272e 0x12e 0xa64b 0x272a 0x25c 0xa5a3 0x27cf 0x38a 0xa507 0x2888 0x4b8 0xa470 0x28d3 0x5e6 0xa3e1 0x290c 0x714 0xa35c 0x2903 0x841 0xa2e1 0x290e 0x96f 0xa270 0x2965 0xa9d 0xa1f7 0x292d 0xbcb 0xa163 0x290f 0xcf9 0xa0af 0x2904 0xe27 0x9fd4 0x2908 0xf55 0x9e97 0x2941 0x1083 0x9d3d 0x2c94 0x11b1 0x9c1b 0x30dd 0x12df 0x9b55 0x34c9 0x140d 0x9abe 0x3643 0x153b 0x9a3e 0x371b 0x1668 0x99cc 0x37a3 0x1796 0x9964 0x37dd 0x18c4 0x9901 0x3720 0x19f2 0x98a5 0x3765 0x1b20 0x984e 0x3759 0x1c4e 0x97fc 0x36c3 0x1d7c 0x97b1 0x369e 0x1eaa 0x976c 0x3704 0x1fd8 0x9728 0x3717 0x2106 0x96e5 0x36c6 0x2234 0x96a9 0x36b3 0x2362 0x966c 0x3670 0x248f 0x9634 0x366a 0x25bd 0x95ff 0x369f 0x26eb 0x95ca 0x36c4 0x2819 0x959c 0x36da 0x2947 0x956b 0x3736 0x2a75 0x9538 0x37a1 0x2ba3 0x950a 0x377c 0x2cd1 0x94e4 0x379a 0x2dff 0x94be 0x37e1 0x2f2d 0x9498 0x3827 0x305b 0x9473 0x3827 0x3189 0x9454 0x384a 0x32b7 0x9431 0x38e2 0x33e4 0x940b 0x396b 0x3512 0x93e6 0x390c 0x3640 0x93bb 0x38ca 0x376e 0x938c 0x3872 0x389c 0x935c 0x37ea 0x39ca 0x932f 0x3776 0x3af8 0x92f7 0x36f4 0x3c26 0x92b7 0x3649 0x3d54 0x927e 0x35cc 0x3e82 0x923c 0x3522 0x3fb0 0x91f8 0x347f 0x40de 0x91b5 0x33d7 0x420b 0x915f 0x3302 0x4339 0x9118 0x324b 0x4467 0x90f0 0x31d7 0x4595 0x90ce 0x319b 0x46c3 0x90b4 0x315a 0x47f1 0x909c 0x311f 0x491f 0x907b 0x30cc 0x4a4d 0x906a 0x30a2 0x4b7b 0x906a 0x30a2 0x4ca9 0x906a 0x30a2 0x4dd7 0x906a 0x30a2 0x4f05 0x906a 0x30a2 0x5033 0x906a 0x30a2 0x5160 0x906a 0x30a2 0x528e 0x906a 0x30a2 0x53bc 0x906a 0x30a2 0x54ea 0x906a 0x30a2 0x5618 0x906a 0x30a2 0x5746 0x906a 0x30a2 0x5874 0x906a 0x30a2 0x59a2 0x906a 0x30a2 0x5ad0 0x906a 0x30a2 0x5bfe 0x906a 0x30a2 0x5d2c 0x906a 0x30a2 0x5e5a 0x906a 0x30a2 0x5f87 0x906a 0x30a2 0x60b5 0x906a 0x30a2 0x61e3 0x906a 0x30a2 0x6311 0x906a 0x30a2 0x643f 0x906a 0x30a2 0x656d 0x906a 0x30a2 0x669b 0x906a 0x30a2 0x67c9 0x906a 0x30a2 0x68f7 0x906a 0x30a2 0x6a25 0x906a 0x30a2 0x6b53 0x906a 0x30a2 0x6c81 0x906a 0x30a2 0x6dae 0x906a 0x30a2 0x6edc 0x906a 0x30a2 0x700a 0x906a 0x30a2 0x7138 0x906a 0x30a2 0x7266 0x906a 0x30a2 0x7394 0x906a 0x30a2 0x74c2 0x906a 0x30a2>;
		battery1_profile_t4_num = <0x64>;
		battery2_profile_t0 = <0x0 0xaae6 0x3e8 0x130 0xaa3f 0x3e8 0x261 0xa9ac 0x3f5 0x391 0xa923 0x3fa 0x4c2 0xa89b 0x3e9 0x5f2 0xa821 0x3fc 0x723 0xa7a7 0x401 0x853 0xa72a 0x3f9 0x984 0xa6ab 0x3ea 0xab4 0xa639 0x3fd 0xbe4 0xa5c0 0x401 0xd15 0xa546 0x401 0xe45 0xa4cd 0x3fe 0xf76 0xa453 0x3eb 0x10a6 0xa3e6 0x409 0x11d7 0xa373 0x410 0x1307 0xa2fb 0x401 0x1438 0xa289 0x401 0x1568 0xa217 0x401 0x1698 0xa1a9 0x40d 0x17c9 0xa13d 0x41a 0x18f9 0xa0cb 0x41a 0x1a2a 0xa060 0x42d 0x1b5a 0x9ff5 0x433 0x1c8b 0x9f8b 0x433 0x1dbb 0x9f20 0x433 0x1eec 0x9eb6 0x433 0x201c 0x9e56 0x441 0x214c 0x9df8 0x44c 0x227d 0x9d94 0x44e 0x23ad 0x9d2f 0x461 0x24de 0x9ccb 0x465 0x260e 0x9c70 0x46f 0x273f 0x9c1b 0x47a 0x286f 0x9bc0 0x467 0x29a0 0x9b6b 0x486 0x2ad0 0x9b1c 0x4ac 0x2c00 0x9ace 0x4c9 0x2d31 0x9a7a 0x4c9 0x2e61 0x9a26 0x4db 0x2f92 0x99d2 0x4ee 0x30c2 0x997a 0x4f5 0x31f3 0x9917 0x4e2 0x3323 0x989e 0x4aa 0x3454 0x9829 0x470 0x3584 0x97bc 0x43e 0x36b4 0x975a 0x419 0x37e5 0x970e 0x406 0x3915 0x96c8 0x3f3 0x3a46 0x9686 0x3e8 0x3b76 0x964a 0x3e8 0x3ca7 0x9615 0x3e8 0x3dd7 0x95e6 0x3f7 0x3f08 0x95b5 0x3f8 0x4038 0x9582 0x3eb 0x4168 0x955c 0x3fe 0x4299 0x952f 0x401 0x43c9 0x9506 0x40b 0x44fa 0x94e0 0x41a 0x462a 0x94b9 0x41a 0x475b 0x9493 0x41a 0x488b 0x946d 0x41a 0x49bc 0x9449 0x41a 0x4aec 0x942b 0x41a 0x4c1c 0x940d 0x42c 0x4d4d 0x93ee 0x433 0x4e7d 0x93d2 0x440 0x4fae 0x93bb 0x465 0x50de 0x939d 0x465 0x520f 0x9379 0x465 0x533f 0x934a 0x44e 0x5470 0x930c 0x418 0x55a0 0x92c0 0x405 0x56d0 0x928b 0x401 0x5801 0x9261 0x401 0x5931 0x923a 0x401 0x5a62 0x920c 0x401 0x5b92 0x91e4 0x401 0x5cc3 0x91be 0x401 0x5df3 0x9198 0x401 0x5f24 0x9172 0x401 0x6054 0x914c 0x412 0x6184 0x9119 0x41a 0x62b5 0x90dc 0x41a 0x63e5 0x909f 0x41a 0x6516 0x9062 0x42c 0x6646 0x9017 0x41b 0x6777 0x8fd0 0x3fb 0x68a7 0x8fa2 0x3e8 0x69d8 0x8f9a 0x40e 0x6b08 0x8f93 0x435 0x6c38 0x8f88 0x463 0x6d69 0x8f74 0x49b 0x6e99 0x8f37 0x4c1 0x6fca 0x8e54 0x48e 0x70fa 0x8ce2 0x480 0x722b 0x8ae0 0x4bc 0x735b 0x881c 0x508 0x748c 0x83cc 0x614 0x75bc 0x7e90 0x401>;
		battery2_profile_t0_num = <0x64>;
		battery2_profile_t1 = <0x0 0xaa5a 0x60e 0x130 0xa9ba 0x60e 0x261 0xa92a 0x60e 0x391 0xa8a4 0x60e 0x4c2 0xa823 0x60e 0x5f2 0xa7a9 0x60e 0x723 0xa72f 0x60e 0x853 0xa6b2 0x606 0x984 0xa633 0x5f5 0xab4 0xa5c1 0x5f5 0xbe4 0xa548 0x5f5 0xd15 0xa4d2 0x5f5 0xe45 0xa460 0x5f8 0xf76 0xa3ee 0x60b 0x10a6 0xa375 0x5fe 0x11d7 0xa300 0x5f5 0x1307 0xa28f 0x5f9 0x1438 0xa225 0x60c 0x1568 0xa1b3 0x60e 0x1698 0xa141 0x60e 0x17c9 0xa0d1 0x614 0x18f9 0xa066 0x627 0x1a2a 0x9ffc 0x63a 0x1b5a 0x9f96 0x640 0x1c8b 0x9f36 0x647 0x1dbb 0x9eda 0x65a 0x1eec 0x9e77 0x66d 0x201c 0x9e0f 0x68e 0x214c 0x9da1 0x6a4 0x227d 0x9d30 0x6a6 0x23ad 0x9cc2 0x6b9 0x24de 0x9c5d 0x6bd 0x260e 0x9c02 0x6c7 0x273f 0x9bae 0x6d6 0x286f 0x9b5b 0x6d6 0x29a0 0x9b0e 0x6e7 0x2ad0 0x9abd 0x6ef 0x2c00 0x9a6a 0x6f4 0x2d31 0x9a16 0x707 0x2e61 0x99bb 0x6f6 0x2f92 0x9956 0x6d8 0x30c2 0x98e9 0x6a6 0x31f3 0x9877 0x65a 0x3323 0x980d 0x60e 0x3454 0x97ac 0x5e8 0x3584 0x9757 0x5ce 0x36b4 0x970b 0x5a9 0x37e5 0x96c6 0x596 0x3915 0x9687 0x591 0x3a46 0x964e 0x591 0x3b76 0x9618 0x591 0x3ca7 0x95e3 0x591 0x3dd7 0x95b4 0x591 0x3f08 0x9586 0x591 0x4038 0x955a 0x594 0x4168 0x9534 0x5a7 0x4299 0x950e 0x5aa 0x43c9 0x94e8 0x5b4 0x44fa 0x94c2 0x5c3 0x462a 0x949b 0x5c3 0x475b 0x947c 0x5c3 0x488b 0x945e 0x5ce 0x49bc 0x943f 0x5dc 0x4aec 0x9421 0x5dc 0x4c1c 0x9403 0x5ee 0x4d4d 0x93e9 0x5f5 0x4e7d 0x93d0 0x5f5 0x4fae 0x93b1 0x5f5 0x50de 0x939b 0x5f5 0x520f 0x937e 0x5f5 0x533f 0x9360 0x5ed 0x5470 0x9341 0x5da 0x55a0 0x931b 0x5c7 0x56d0 0x92f5 0x5b4 0x5801 0x92cf 0x5aa 0x5931 0x92a9 0x5ad 0x5a62 0x9283 0x5c0 0x5b92 0x925c 0x5c3 0x5cc3 0x923a 0x5cd 0x5df3 0x9219 0x5dc 0x5f24 0x91eb 0x5dc 0x6054 0x91b0 0x5ed 0x6184 0x9173 0x5f5 0x62b5 0x9136 0x5fa 0x63e5 0x90f9 0x60d 0x6516 0x90a7 0x60e 0x6646 0x9062 0x602 0x6777 0x9036 0x601 0x68a7 0x902e 0x627 0x69d8 0x901f 0x64d 0x6b08 0x900f 0x681 0x6c38 0x8ff6 0x6cb 0x6d69 0x8fc3 0x725 0x6e99 0x8f0c 0x74b 0x6fca 0x8d79 0x771 0x70fa 0x8b4d 0x7e7 0x722b 0x8874 0x8d8 0x735b 0x842c 0xa7b 0x748c 0x7fc6 0x6fd 0x75bc 0x7fc6 0x708>;
		battery2_profile_t1_num = <0x64>;
		battery2_profile_t2 = <0x0 0xa910 0xc9e 0x130 0xa833 0xc9a 0x261 0xa78b 0xce7 0x391 0xa6fd 0xd2f 0x4c2 0xa675 0xd2e 0x5f2 0xa5fb 0xd1b 0x723 0xa57c 0xd24 0x853 0xa4fe 0xd1f 0x984 0xa485 0xcff 0xab4 0xa413 0xd12 0xbe4 0xa3a0 0xd16 0xd15 0xa32e 0xd16 0xe45 0xa2bc 0xd13 0xf76 0xa24a 0xd00 0x10a6 0xa1de 0xd2e 0x11d7 0xa170 0xd5d 0x1307 0xa0ff 0xd7e 0x1438 0xa095 0xd91 0x1568 0xa02a 0xd93 0x1698 0x9fc4 0xd9f 0x17c9 0x9f66 0xdb7 0x18f9 0x9f12 0xddd 0x1a2a 0x9eb7 0xe28 0x1b5a 0x9e47 0xe35 0x1c8b 0x9dc5 0xe22 0x1dbb 0x9d35 0xe0e 0x1eec 0x9cac 0xdd5 0x201c 0x9c3f 0xde1 0x214c 0x9be5 0xdf7 0x227d 0x9b99 0xdf9 0x23ad 0x9b4b 0xe0c 0x24de 0x9b04 0xe2f 0x260e 0x9abc 0xe1c 0x273f 0x9a70 0xde2 0x286f 0x9a24 0xdf5 0x29a0 0x99c4 0xe08 0x2ad0 0x9958 0xdf0 0x2c00 0x98e6 0xda0 0x2d31 0x9874 0xd08 0x2e61 0x9809 0xcfd 0x2f92 0x97a8 0xce6 0x30c2 0x974f 0xcb4 0x31f3 0x96fb 0xc68 0x3323 0x96b6 0xc67 0x3454 0x9677 0xc74 0x3584 0x963d 0xc87 0x36b4 0x9607 0xc9b 0x37e5 0x95d2 0xcc1 0x3915 0x95a3 0xcf5 0x3a46 0x9572 0xd0e 0x3b76 0x953e 0xcf7 0x3ca7 0x9518 0xcbe 0x3dd7 0x94f2 0xcdf 0x3f08 0x94cf 0xd21 0x4038 0x94b0 0xd67 0x4168 0x948a 0xd8d 0x4299 0x946a 0xd62 0x43c9 0x9448 0xd48 0x44fa 0x9425 0xd55 0x462a 0x940e 0xd8e 0x475b 0x93f7 0xdc7 0x488b 0x93e0 0xe0b 0x49bc 0x93ca 0xe2d 0x4aec 0x93b3 0xde1 0x4c1c 0x93a3 0xe3a 0x4d4d 0x9394 0xe8d 0x4e7d 0x9385 0xeb9 0x4fae 0x9375 0xea6 0x50de 0x935f 0xeba 0x520f 0x9342 0xf1e 0x533f 0x9324 0xf50 0x5470 0x9305 0xf12 0x55a0 0x92df 0xf71 0x56d0 0x92b3 0xfd0 0x5801 0x9289 0xffb 0x5931 0x9262 0xff3 0x5a62 0x9234 0x102c 0x5b92 0x91fa 0x10a4 0x5cc3 0x91b9 0x1133 0x5df3 0x9176 0x11b5 0x5f24 0x9139 0x11db 0x6054 0x90e8 0x1277 0x6184 0x909d 0x12f7 0x62b5 0x9060 0x1387 0x63e5 0x903a 0x14a4 0x6516 0x9022 0x1544 0x6646 0x900c 0x166c 0x6777 0x8ff0 0x180d 0x68a7 0x8fca 0x19fc 0x69d8 0x8f41 0x1c37 0x6b08 0x8de8 0x1e61 0x6c38 0x8be9 0x2044 0x6d69 0x895b 0x1f0c 0x6e99 0x85f1 0x165a 0x6fca 0x8368 0x101d 0x70fa 0x8368 0x101d 0x722b 0x8368 0x101d 0x735b 0x8368 0x101d 0x748c 0x8368 0x101d 0x75bc 0x8368 0x101d>;
		battery2_profile_t2_num = <0x64>;
		battery2_profile_t3 = <0x0 0xa956 0x15cc 0x130 0xa8a7 0x15c8 0x261 0xa7de 0x15fb 0x391 0xa6d6 0x1647 0x4c2 0xa57e 0x16b4 0x5f2 0xa48a 0x1928 0x723 0xa3d5 0x1a9d 0x853 0xa342 0x1b99 0x984 0xa2c2 0x1c5f 0xab4 0xa248 0x1cd2 0xbe4 0xa1ce 0x1cd9 0xd15 0xa158 0x1ca0 0xe45 0xa0e7 0x1c41 0xf76 0xa07d 0x1be2 0x10a6 0xa019 0x1c89 0x11d7 0x9fba 0x1d1c 0x1307 0x9f5f 0x1d3d 0x1438 0x9f03 0x1c92 0x1568 0x9e93 0x1cdc 0x1698 0x9e0a 0x1d24 0x17c9 0x9d72 0x1d41 0x18f9 0x9cd9 0x1d1b 0x1a2a 0x9c57 0x1c85 0x1b5a 0x9be5 0x1c13 0x1c8b 0x9b83 0x1bf6 0x1dbb 0x9b2f 0x1c54 0x1eec 0x9adb 0x1c8d 0x201c 0x9a88 0x1c8f 0x214c 0x9a31 0x1c9b 0x227d 0x99d4 0x1ccd 0x23ad 0x9966 0x1cba 0x24de 0x98fb 0x1c0c 0x260e 0x988d 0x1b60 0x273f 0x981f 0x1b14 0x286f 0x97c4 0x1bbf 0x29a0 0x976f 0x1b50 0x2ad0 0x9724 0x1b18 0x2c00 0x96df 0x1b21 0x2d31 0x969b 0x1b0e 0x2e61 0x965d 0x1bac 0x2f92 0x9625 0x1bee 0x30c2 0x95f0 0x1bc0 0x31f3 0x95bb 0x1b28 0x3323 0x958d 0x1c1b 0x3454 0x955f 0x1bf7 0x3584 0x9534 0x1bba 0x36b4 0x950e 0x1c3e 0x37e5 0x94e0 0x1cb1 0x3915 0x94b8 0x1c51 0x3a46 0x9495 0x1c6e 0x3b76 0x9476 0x1d6e 0x3ca7 0x9450 0x1cd6 0x3dd7 0x9436 0x1d3e 0x3f08 0x941f 0x1d6a 0x4038 0x9408 0x1d33 0x4168 0x93f1 0x1dcb 0x4299 0x93e1 0x1dd2 0x43c9 0x93d2 0x1dfc 0x44fa 0x93c1 0x1e81 0x462a 0x93aa 0x1f8c 0x475b 0x938c 0x1f2b 0x488b 0x9372 0x1f5b 0x49bc 0x9359 0x1ffb 0x4aec 0x933b 0x2081 0x4c1c 0x9315 0x203b 0x4d4d 0x92f4 0x210d 0x4e7d 0x92d3 0x221c 0x4fae 0x92ad 0x227b 0x50de 0x9277 0x22c7 0x520f 0x9242 0x2306 0x533f 0x920a 0x23d6 0x5470 0x91cd 0x2579 0x55a0 0x9190 0x264a 0x56d0 0x9142 0x26b5 0x5801 0x90ee 0x271b 0x5931 0x909e 0x27b6 0x5a62 0x9069 0x28d3 0x5b92 0x9047 0x2b3c 0x5cc3 0x902c 0x2d38 0x5df3 0x9014 0x2e83 0x5f24 0x8ff6 0x2f68 0x6054 0x8fc6 0x2efb 0x6184 0x8f59 0x2de0 0x62b5 0x8e3e 0x2b30 0x63e5 0x8c59 0x2677 0x6516 0x89ea 0x2079 0x6646 0x88c2 0x1d7e 0x6777 0x88c2 0x1d7e 0x68a7 0x88c2 0x1d7e 0x69d8 0x88c2 0x1d7e 0x6b08 0x88c2 0x1d7e 0x6c38 0x88c2 0x1d7e 0x6d69 0x88c2 0x1d7e 0x6e99 0x88c2 0x1d7e 0x6fca 0x88c2 0x1d7e 0x70fa 0x88c2 0x1d7e 0x722b 0x88c2 0x1d7e 0x735b 0x88c2 0x1d7e 0x748c 0x88c2 0x1d7e 0x75bc 0x88c2 0x1d7e>;
		battery2_profile_t3_num = <0x64>;
		battery2_profile_t4 = <0x0 0xa7e4 0x2c24 0x130 0xa73d 0x2c24 0x261 0xa6a0 0x2d1c 0x391 0xa60a 0x2dbf 0x4c2 0xa57a 0x2d1b 0x5f2 0xa4e9 0x2ce2 0x723 0xa45e 0x2ce1 0x853 0xa3d2 0x2d0d 0x984 0xa344 0x2d3e 0xab4 0xa2ca 0x2ca6 0xbe4 0xa22c 0x2c69 0xd15 0xa149 0x2c97 0xe45 0xa01b 0x2dc3 0xf76 0x9eb6 0x3200 0x10a6 0x9dd3 0x33ff 0x11d7 0x9d12 0x3524 0x1307 0x9c5d 0x35cc 0x1438 0x9bae 0x362b 0x1568 0x9b1b 0x35b9 0x1698 0x9a94 0x3533 0x17c9 0x9a19 0x34cf 0x18f9 0x99ae 0x34bc 0x1a2a 0x994b 0x3564 0x1b5a 0x98f2 0x3538 0x1c8b 0x989f 0x34f0 0x1dbb 0x984c 0x3532 0x1eec 0x9807 0x3474 0x201c 0x97bd 0x33fa 0x214c 0x9777 0x33ca 0x227d 0x973a 0x33d9 0x23ad 0x96f5 0x33c6 0x24de 0x96b6 0x33e0 0x260e 0x967d 0x3444 0x273f 0x9648 0x34d8 0x286f 0x9613 0x34eb 0x29a0 0x95dd 0x34ee 0x2ad0 0x95a8 0x3480 0x2c00 0x9574 0x340b 0x2d31 0x9547 0x34f0 0x2e61 0x9519 0x348f 0x2f92 0x94eb 0x3437 0x30c2 0x94be 0x341c 0x31f3 0x9490 0x3456 0x3323 0x946a 0x3532 0x3454 0x943f 0x3553 0x3584 0x9411 0x354c 0x36b4 0x93e3 0x35ce 0x37e5 0x93b6 0x356e 0x3915 0x9383 0x3635 0x3a46 0x934d 0x36cf 0x3b76 0x9317 0x3668 0x3ca7 0x92d7 0x3690 0x3dd7 0x929a 0x3600 0x3f08 0x9258 0x355e 0x4038 0x9212 0x34b6 0x4168 0x91c8 0x33f4 0x4299 0x917f 0x333d 0x43c9 0x913a 0x3290 0x44fa 0x9103 0x3221 0x462a 0x90df 0x31c6 0x475b 0x90c4 0x316a 0x488b 0x90a6 0x311f 0x49bc 0x907f 0x30bf 0x4aec 0x904f 0x3057 0x4c1c 0x8fe4 0x2f4a 0x4d4d 0x8f7a 0x2e4a 0x4e7d 0x8f7a 0x2e4a 0x4fae 0x8f7a 0x2e4a 0x50de 0x8f7a 0x2e4a 0x520f 0x8f7a 0x2e4a 0x533f 0x8f7a 0x2e4a 0x5470 0x8f7a 0x2e4a 0x55a0 0x8f7a 0x2e4a 0x56d0 0x8f7a 0x2e4a 0x5801 0x8f7a 0x2e4a 0x5931 0x8f7a 0x2e4a 0x5a62 0x8f7a 0x2e4a 0x5b92 0x8f7a 0x2e4a 0x5cc3 0x8f7a 0x2e4a 0x5df3 0x8f7a 0x2e4a 0x5f24 0x8f7a 0x2e4a 0x6054 0x8f7a 0x2e4a 0x6184 0x8f7a 0x2e4a 0x62b5 0x8f7a 0x2e4a 0x63e5 0x8f7a 0x2e4a 0x6516 0x8f7a 0x2e4a 0x6646 0x8f7a 0x2e4a 0x6777 0x8f7a 0x2e4a 0x68a7 0x8f7a 0x2e4a 0x69d8 0x8f7a 0x2e4a 0x6b08 0x8f7a 0x2e4a 0x6c38 0x8f7a 0x2e4a 0x6d69 0x8f7a 0x2e4a 0x6e99 0x8f7a 0x2e4a 0x6fca 0x8f7a 0x2e4a 0x70fa 0x8f7a 0x2e4a 0x722b 0x8f7a 0x2e4a 0x735b 0x8f7a 0x2e4a 0x748c 0x8f7a 0x2e4a 0x75bc 0x8f7a 0x2e4a>;
		battery2_profile_t4_num = <0x64>;
		compatible = "mediatek,bat_gm30";
		g_FG_PSEUDO100_T0 = <0x62>;
		g_FG_PSEUDO100_T1 = <0x62>;
		g_FG_PSEUDO100_T2 = <0x62>;
		g_FG_PSEUDO100_T3 = <0x62>;
		g_FG_PSEUDO100_T4 = <0x62>;
		linux,phandle = <0x57>;
		phandle = <0x57>;
	};

	board_id {
		compatible = "dura_boardid";
		linux,phandle = <0x70>;
		phandle = <0x70>;
	};

	bpi_bsi_slv0@1021e000 {
		compatible = "mediatek,bpi_bsi_slv0";
		reg = <0x0 0x1021e000 0x0 0x1000>;
	};

	bpi_bsi_slv1@1021f000 {
		compatible = "mediatek,bpi_bsi_slv1";
		reg = <0x0 0x1021f000 0x0 0x6000>;
	};

	bpi_bsi_slv2@10225000 {
		compatible = "mediatek,bpi_bsi_slv2";
		reg = <0x0 0x10225000 0x0 0x1000>;
	};

	btcvsd@10001000 {
		compatible = "mediatek,audio_bt_cvsd";
		interrupts = <0x0 0xe8 0x8>;
		offset = <0xf00 0x800 0xfd0 0xfd4 0xfd8>;
		reg = <0x0 0x10001000 0x0 0x1000 0x0 0x18000000 0x0 0x10000 0x0 0x18080000 0x0 0x8000>;
	};

	btif@1100c000 {
		#address-cells = <0x2>;
		#size-cells = <0x2>;
		clock-names = "btifc", "apdmac";
		clocks = <0x19 0x1a 0x19 0x28>;
		compatible = "mediatek,btif";
		interrupts = <0x0 0x70 0x8 0x0 0x6c 0x8 0x0 0x6d 0x8>;
		reg = <0x0 0x1100c000 0x0 0x1000 0x0 0x11000600 0x0 0x80 0x0 0x11000680 0x0 0x80>;
	};

	bus_dbg@10208000 {
		compatible = "mediatek,bus_dbg-v2";
		interrupts = <0x0 0x8d 0x8>;
		mediatek,bus_dbg_con_offset = <0x2fc>;
		reg = <0x0 0x10208000 0x0 0x1000 0x0 0x10001000 0x0 0x1000>;
	};

	cam_a@15004000 {
		compatible = "mediatek,cam_a";
		reg = <0x0 0x15004000 0x0 0x1000>;
	};

	cam_a_inner@1500d000 {
		compatible = "mediatek,cam_a_inner";
		reg = <0x0 0x1500d000 0x0 0x1000>;
	};

	cam_b@15005000 {
		compatible = "mediatek,cam_b";
		interrupts = <0x0 0xd9 0x8>;
		reg = <0x0 0x15005000 0x0 0x1000>;
	};

	cam_c@15006000 {
		compatible = "mediatek,cam_c";
		interrupts = <0x0 0xda 0x8>;
		reg = <0x0 0x15006000 0x0 0x1000>;
	};

	cam_c_inner@1500e000 {
		compatible = "mediatek,cam_c_inner";
		reg = <0x0 0x1500e000 0x0 0x1000>;
	};

	cam_d@15007000 {
		compatible = "mediatek,cam_d";
		interrupts = <0x0 0xdb 0x8>;
		reg = <0x0 0x15007000 0x0 0x1000>;
	};

	cam_d_inner@1500f000 {
		compatible = "mediatek,cam_d_inner";
		reg = <0x0 0x1500f000 0x0 0x1000>;
	};

	camsv@15009000 {
		compatible = "mediatek,camsv";
		interrupts = <0x0 0xdc 0x8>;
		reg = <0x0 0x15009000 0x0 0x1000>;
	};

	charger {
		ac_charger_current = <0x162010>;
		ac_charger_input_current = <0x162010>;
		algorithm_name = "SwitchCharging";
		apple_1_0a_charger_current = <0x9eb10>;
		apple_2_1a_charger_current = <0xc3500>;
		battery_cv = <0x42d560>;
		bif_cv_under_threshold2 = <0x43e6d0>;
		bif_threshold1 = <0x40d990>;
		bif_threshold2 = <0x419ce0>;
		cable_imp_threshold = <0x2bb>;
		charging_host_charger_current = <0x100590>;
		chg1_ta_ac_charger_current = <0x16e360>;
		chg2_ta_ac_charger_current = <0x16e360>;
		chg_full_current = <0x249f0>;
		compatible = "mediatek,charger";
		enable_min_charge_temperature;
		enable_pe_2;
		enable_pe_3;
		enable_pe_plus;
		enable_sw_jeita;
		enable_sw_safety_timer;
		jeita_temp_above_t4_cv_voltage = <0x3e8fa0>;
		jeita_temp_below_t0_cv_voltage = <0x3da540>;
		jeita_temp_t0_to_t1_cv_voltage = <0x432380>;
		jeita_temp_t1_to_t2_cv_voltage = <0x432380>;
		jeita_temp_t2_to_t3_cv_voltage = <0x432380>;
		jeita_temp_t3_to_t4_cv_voltage = <0x3e8fa0>;
		linux,phandle = <0x5a>;
		max_charge_temperature = <0x32>;
		max_charge_temperature_minus_x_degree = <0x2f>;
		max_charger_voltage = <0x632ea0>;
		max_charging_time = <0xa8c0>;
		min_charge_temperature = <0x0>;
		min_charge_temperature_plus_x_degree = <0x6>;
		min_charger_voltage = <0x4630c0>;
		non_std_ac_charger_current = <0x100590>;
		pe20_ichg_level_threshold = <0x3e8>;
		phandle = <0x5a>;
		recharge_offset = <0x249f0>;
		ta_ac_charger_current = <0x2dc6c0>;
		ta_start_battery_soc = <0x0>;
		ta_stop_battery_soc = <0x55>;
		temp_neg_10_threshold = <0x0>;
		temp_t0_threshold = <0x0>;
		temp_t1_threshold = <0x5>;
		temp_t2_threshold = <0xa>;
		temp_t3_threshold = <0x2d>;
		temp_t4_thres_minus_x_degree = <0x2f>;
		temp_t4_threshold = <0x32>;
		topoff_voltage = <0x401640>;
		usb_charger_current = <0x7a120>;
		usb_charger_current_configured = <0x7a120>;
		usb_charger_current_suspend = <0x0>;
		usb_charger_current_unconfigured = <0x11170>;
		vbat_cable_imp_threshold = <0xf3c>;
	};

	chipid@08000000 {
		compatible = "mediatek,chipid";
		reg = <0x0 0x8000000 0x0 0x4 0x0 0x8000004 0x0 0x4 0x0 0x8000008 0x0 0x4 0x0 0x800000c 0x0 0x4>;
	};

	chosen {
		bootargs = "console=tty0 console=ttyMT0,921600n1 root=/dev/ram initrd=0x44000000,0x1000000 loglevel=8 androidboot.selinux=permissive";
		linux,phandle = <0x38>;
		phandle = <0x38>;
	};

	chr_stat {
		linux,phandle = <0x6a>;
		phandle = <0x6a>;
	};

	clk26m {
		#clock-cells = <0x0>;
		clock-frequency = <0x18cba80>;
		compatible = "fixed-clock";
		linux,phandle = <0x26>;
		phandle = <0x26>;
	};

	clk32k {
		#clock-cells = <0x0>;
		clock-frequency = <0x7d00>;
		compatible = "fixed-clock";
		linux,phandle = <0x18>;
		phandle = <0x18>;
	};

	consys@18070000 {
		#address-cells = <0x2>;
		#size-cells = <0x2>;
		clock-names = "conn";
		clocks = <0x1a 0x3>;
		compatible = "mediatek,mt6739-consys";
		interrupts = <0x0 0xe9 0x8 0x0 0xeb 0x2>;
		linux,phandle = <0x5c>;
		phandle = <0x5c>;
		reg = <0x0 0x18070000 0x0 0x200 0x0 0x10007000 0x0 0x100 0x0 0x10000000 0x0 0x2000 0x0 0x10006000 0x0 0x1000>;
	};

	cpu_dbgapb {
		compatible = "mediatek,hw_dbg";
		linux,phandle = <0x39>;
		num = <0x4>;
		phandle = <0x39>;
		reg = <0x0 0xd410000 0x0 0x1000 0x0 0xd510000 0x0 0x1000 0x0 0xd610000 0x0 0x1000 0x0 0xd710000 0x0 0x1000>;
	};

	cpus {
		#address-cells = <0x1>;
		#size-cells = <0x0>;

		cpu-map {

			cluster0 {

				core0 {
					cpu = <0xa>;
				};

				core1 {
					cpu = <0xb>;
				};

				core2 {
					cpu = <0xc>;
				};

				core3 {
					cpu = <0xd>;
				};
			};
		};

		cpu@0 {
			clock-frequency = <0x77359400>;
			compatible = "arm,cortex-a53";
			cpu-idle-states = <0x3 0x4 0x5 0x6 0x7 0x8 0x9>;
			cpu-release-addr = <0x0 0x40000200>;
			device_type = "cpu";
			enable-method = "psci";
			linux,phandle = <0xa>;
			phandle = <0xa>;
			reg = <0x0>;
		};

		cpu@001 {
			clock-frequency = <0x61a1e580>;
			compatible = "arm,cortex-a53";
			cpu-idle-states = <0x3 0x4 0x5 0x6 0x7 0x8 0x9>;
			cpu-release-addr = <0x0 0x40000200>;
			device_type = "cpu";
			enable-method = "psci";
			linux,phandle = <0xb>;
			phandle = <0xb>;
			reg = <0x1>;
		};

		cpu@002 {
			clock-frequency = <0x61a1e580>;
			compatible = "arm,cortex-a53";
			cpu-idle-states = <0x3 0x4 0x5 0x6 0x7 0x8 0x9>;
			cpu-release-addr = <0x0 0x40000200>;
			device_type = "cpu";
			enable-method = "psci";
			linux,phandle = <0xc>;
			phandle = <0xc>;
			reg = <0x2>;
		};

		cpu@003 {
			clock-frequency = <0x61a1e580>;
			compatible = "arm,cortex-a53";
			cpu-idle-states = <0x3 0x4 0x5 0x6 0x7 0x8 0x9>;
			cpu-release-addr = <0x0 0x40000200>;
			device_type = "cpu";
			enable-method = "psci";
			linux,phandle = <0xd>;
			phandle = <0xd>;
			reg = <0x3>;
		};

		idle-states {
			entry-method = "arm,psci";

			dpidle {
				arm,psci-suspend-param = <0x1010004>;
				compatible = "arm,idle-state";
				entry-latency-us = <0x320>;
				exit-latency-us = <0x3e8>;
				linux,phandle = <0x8>;
				min-residency-us = <0x7d0>;
				phandle = <0x8>;
			};

			mcdi-cluster {
				arm,psci-suspend-param = <0x1010001>;
				compatible = "arm,idle-state";
				entry-latency-us = <0x258>;
				exit-latency-us = <0x258>;
				linux,phandle = <0x5>;
				min-residency-us = <0x4b0>;
				phandle = <0x5>;
			};

			mcdi-cpu {
				arm,psci-suspend-param = <0x10001>;
				compatible = "arm,idle-state";
				entry-latency-us = <0x258>;
				exit-latency-us = <0x258>;
				linux,phandle = <0x4>;
				min-residency-us = <0x4b0>;
				phandle = <0x4>;
			};

			sodi {
				arm,psci-suspend-param = <0x1010002>;
				compatible = "arm,idle-state";
				entry-latency-us = <0x320>;
				exit-latency-us = <0x3e8>;
				linux,phandle = <0x6>;
				min-residency-us = <0x7d0>;
				phandle = <0x6>;
			};

			sodi3 {
				arm,psci-suspend-param = <0x1010003>;
				compatible = "arm,idle-state";
				entry-latency-us = <0x320>;
				exit-latency-us = <0x3e8>;
				linux,phandle = <0x7>;
				min-residency-us = <0x7d0>;
				phandle = <0x7>;
			};

			standby {
				arm,psci-suspend-param = <0x1>;
				compatible = "arm,idle-state";
				entry-latency-us = <0x258>;
				exit-latency-us = <0x258>;
				linux,phandle = <0x3>;
				min-residency-us = <0x4b0>;
				phandle = <0x3>;
			};

			suspend {
				arm,psci-suspend-param = <0x1010005>;
				compatible = "arm,idle-state";
				entry-latency-us = <0x320>;
				exit-latency-us = <0x3e8>;
				linux,phandle = <0x9>;
				min-residency-us = <0x7d0>;
				phandle = <0x9>;
			};
		};
	};

	cq_dma@10212000 {
		clock-names = "cqdma";
		clocks = <0x19 0x44>;
		compatible = "mediatek,mt-cqdma-v1";
		interrupts = <0x0 0x72 0x8>;
		keep_clock_ao = "yes";
		nr_channel = <0x1>;
		reg = <0x0 0x10212080 0x0 0x80>;
	};

	dbg_apmcu_mp0@0d400000 {
		compatible = "mediatek,dbg_apmcu_mp0";
		reg = <0x0 0xd400000 0x0 0x1000>;
	};

	dbg_apmcu_mp0@0d410000 {
		compatible = "mediatek,dbg_apmcu_mp0";
		reg = <0x0 0xd410000 0x0 0x1000>;
	};

	dbg_apmcu_mp0@0d420000 {
		compatible = "mediatek,dbg_apmcu_mp0";
		reg = <0x0 0xd420000 0x0 0x1000>;
	};

	dbg_apmcu_mp0@0d430000 {
		compatible = "mediatek,dbg_apmcu_mp0";
		reg = <0x0 0xd430000 0x0 0x1000>;
	};

	dbg_apmcu_mp0@0d440000 {
		compatible = "mediatek,dbg_apmcu_mp0";
		reg = <0x0 0xd440000 0x0 0x1000>;
	};

	dbg_apmcu_mp0@0d510000 {
		compatible = "mediatek,dbg_apmcu_mp0";
		reg = <0x0 0xd510000 0x0 0x1000>;
	};

	dbg_apmcu_mp0@0d520000 {
		compatible = "mediatek,dbg_apmcu_mp0";
		reg = <0x0 0xd520000 0x0 0x1000>;
	};

	dbg_apmcu_mp0@0d530000 {
		compatible = "mediatek,dbg_apmcu_mp0";
		reg = <0x0 0xd530000 0x0 0x1000>;
	};

	dbg_apmcu_mp0@0d540000 {
		compatible = "mediatek,dbg_apmcu_mp0";
		reg = <0x0 0xd540000 0x0 0x1000>;
	};

	dbg_apmcu_mp0@0d610000 {
		compatible = "mediatek,dbg_apmcu_mp0";
		reg = <0x0 0xd610000 0x0 0x1000>;
	};

	dbg_apmcu_mp0@0d620000 {
		compatible = "mediatek,dbg_apmcu_mp0";
		reg = <0x0 0xd620000 0x0 0x1000>;
	};

	dbg_apmcu_mp0@0d630000 {
		compatible = "mediatek,dbg_apmcu_mp0";
		reg = <0x0 0xd630000 0x0 0x1000>;
	};

	dbg_apmcu_mp0@0d640000 {
		compatible = "mediatek,dbg_apmcu_mp0";
		reg = <0x0 0xd640000 0x0 0x1000>;
	};

	dbg_apmcu_mp0@0d710000 {
		compatible = "mediatek,dbg_apmcu_mp0";
		reg = <0x0 0xd710000 0x0 0x1000>;
	};

	dbg_apmcu_mp0@0d720000 {
		compatible = "mediatek,dbg_apmcu_mp0";
		reg = <0x0 0xd720000 0x0 0x1000>;
	};

	dbg_apmcu_mp0@0d730000 {
		compatible = "mediatek,dbg_apmcu_mp0";
		reg = <0x0 0xd730000 0x0 0x1000>;
	};

	dbg_apmcu_mp0@0d740000 {
		compatible = "mediatek,dbg_apmcu_mp0";
		reg = <0x0 0xd740000 0x0 0x1000>;
	};

	dbg_apmcu_mp1@0d800000 {
		compatible = "mediatek,dbg_apmcu_mp1";
		reg = <0x0 0xd800000 0x0 0x0>;
	};

	dbg_cti@0d020000 {
		compatible = "mediatek,dbg_cti";
		reg = <0x0 0xd020000 0x0 0x10000>;
	};

	dbg_dem@0d0a0000 {
		compatible = "mediatek,dbg_dem";
		interrupts = <0x0 0x8c 0x8>;
		reg = <0x0 0xd0a0000 0x0 0x10000>;
	};

	dbg_etb@0d010000 {
		compatible = "mediatek,dbg_etb";
		reg = <0x0 0xd010000 0x0 0x10000>;
	};

	dbg_etr@0d030000 {
		compatible = "mediatek,dbg_etr";
		reg = <0x0 0xd030000 0x0 0x10000>;
	};

	dbg_funnel@0d040000 {
		compatible = "mediatek,dbg_funnel";
		reg = <0x0 0xd040000 0x0 0x10000>;
	};

	dbg_mdsys1@0d0c0000 {
		compatible = "mediatek,dbg_mdsys1";
		reg = <0x0 0xd0c0000 0x0 0x40000>;
	};

	dbi0@14013000 {
		compatible = "mediatek,dbi0";
		interrupts = <0x0 0xd2 0x8>;
		reg = <0x0 0x14013000 0x0 0x1000>;
	};

	ddrphy@1001e000 {
		compatible = "mediatek,ddrphy";
		reg = <0x0 0x1001e000 0x0 0x1000>;
	};

	devapc@10207000 {
		clock-names = "devapc-infra-clock";
		clocks = <0x19 0x2a>;
		compatible = "mediatek,devapc";
		interrupts = <0x0 0x8e 0x8>;
		reg = <0x0 0x10207000 0x0 0x1000>;
	};

	dfd@0c600000 {
		compatible = "mediatek,dfd";
		reg = <0x0 0xc600000 0x0 0x0>;
	};

	disp_aal0@1400f000 {
		aal_support = <0x1>;
		compatible = "mediatek,disp_aal0";
		interrupts = <0x0 0xce 0x8>;
		linux,phandle = <0x53>;
		phandle = <0x53>;
		reg = <0x0 0x1400f000 0x0 0x1000>;
	};

	disp_ccorr0@1400e000 {
		compatible = "mediatek,disp_ccorr0";
		interrupts = <0x0 0xcd 0x8>;
		reg = <0x0 0x1400e000 0x0 0x1000>;
	};

	disp_color0@1400d000 {
		compatible = "mediatek,disp_color0";
		interrupts = <0x0 0xcc 0x8>;
		reg = <0x0 0x1400d000 0x0 0x1000>;
	};

	disp_dither0@14011000 {
		compatible = "mediatek,disp_dither0";
		interrupts = <0x0 0xd0 0x8>;
		reg = <0x0 0x14011000 0x0 0x1000>;
	};

	disp_gamma0@14010000 {
		compatible = "mediatek,disp_gamma0";
		interrupts = <0x0 0xcf 0x8>;
		reg = <0x0 0x14010000 0x0 0x1000>;
	};

	disp_mutex@14001000 {
		compatible = "mediatek,disp_mutex";
		interrupts = <0x0 0xc2 0x8>;
		linux,phandle = <0x23>;
		phandle = <0x23>;
		reg = <0x0 0x14001000 0x0 0x1000>;
	};

	disp_ovl0@1400a000 {
		clock-names = "DISP_OVL0";
		clocks = <0x1b 0xc>;
		compatible = "mediatek,disp_ovl0";
		interrupts = <0x0 0xc9 0x8>;
		linux,phandle = <0x22>;
		phandle = <0x22>;
		reg = <0x0 0x1400a000 0x0 0x1000>;
	};

	disp_pwm0@1100e000 {
		compatible = "mediatek,disp_pwm0";
		reg = <0x0 0x1100e000 0x0 0x1000>;
	};

	disp_rdma0@1400b000 {
		compatible = "mediatek,disp_rdma0";
		interrupts = <0x0 0xca 0x8>;
		reg = <0x0 0x1400b000 0x0 0x1000>;
	};

	disp_wdma0@1400c000 {
		compatible = "mediatek,disp_wdma0";
		interrupts = <0x0 0xcb 0x8>;
		reg = <0x0 0x1400c000 0x0 0x1000>;
	};

	dispsys@14000000 {
		clock-names = "CLK_MM_MTCMOS", "CLK_MM_SMI_COMMON", "CLK_MM_SMI_LARB0", "CLK_MM_GALS_COMM0", "CLK_MM_GALS_COMM1", "CLK_MM_DISP_OVL0", "CLK_MM_DISP_RDMA0", "CLK_MM_DISP_WDMA0", "CLK_MM_DISP_COLOR0", "CLK_MM_DISP_CCORR0", "CLK_MM_DISP_AAL0", "CLK_MM_DISP_GAMMA0", "CLK_MM_DISP_DITHER0", "CLK_MM_DSI_MM_CLOCK", "CLK_MM_DSI_INTERF", "CLK_MM_F26M_HRT", "MDP_WROT0", "DISP_PWM", "MUX_PWM", "CLK26M", "UNIVPLL2_D4", "UNIVPLL2_D8", "UNIVPLL3_D8";
		clocks = <0x1a 0x4 0x1b 0x0 0x1b 0x1 0x1b 0x2 0x1b 0x3 0x1b 0xc 0x1b 0xd 0x1b 0xe 0x1b 0xf 0x1b 0x10 0x1b 0x11 0x1b 0x12 0x1b 0x13 0x1b 0x14 0x1b 0x15 0x1b 0x18 0x1b 0x9 0x19 0x33 0x25 0x39 0x26 0x25 0x19 0x25 0x1a 0x25 0x1f>;
		compatible = "mediatek,dispsys";
		linux,phandle = <0x54>;
		phandle = <0x54>;
	};

	dramc0@1001d000 {
		compatible = "mediatek,dramc0";
		reg = <0x0 0x1001d000 0x0 0x1000>;
	};

	dramc@1001d000 {
		compatible = "mediatek,dramc";
		reg = <0x0 0x1001d000 0x0 0x1000 0x0 0x1021d000 0x0 0x1000 0x0 0x1001e000 0x0 0x1000>;
	};

	dramc_ch0_rsv@1022e000 {
		compatible = "mediatek,dramc_ch0_rsv";
		reg = <0x0 0x1022e000 0x0 0x2000>;
	};

	dramc_ch0_top0@10228000 {
		compatible = "mediatek,dramc_ch0_top0";
		reg = <0x0 0x10228000 0x0 0x2000>;
	};

	dramc_ch0_top1@1022a000 {
		compatible = "mediatek,dramc_ch0_top1";
		reg = <0x0 0x1022a000 0x0 0x2000>;
	};

	dramc_ch0_top2@1022c000 {
		compatible = "mediatek,dramc_ch0_top2";
		reg = <0x0 0x1022c000 0x0 0x1000>;
	};

	dramc_ch0_top3@1022d000 {
		compatible = "mediatek,dramc_ch0_top3";
		reg = <0x0 0x1022d000 0x0 0x1000>;
	};

	dramc_ch1_rsv@10236000 {
		compatible = "mediatek,dramc_ch1_rsv";
		reg = <0x0 0x10236000 0x0 0x2000>;
	};

	dramc_ch1_top0@10230000 {
		compatible = "mediatek,dramc_ch1_top0";
		reg = <0x0 0x10230000 0x0 0x2000>;
	};

	dramc_ch1_top1@10232000 {
		compatible = "mediatek,dramc_ch1_top1";
		reg = <0x0 0x10232000 0x0 0x2000>;
	};

	dramc_ch1_top2@10234000 {
		compatible = "mediatek,dramc_ch1_top2";
		reg = <0x0 0x10234000 0x0 0x1000>;
	};

	dramc_ch1_top3@10235000 {
		compatible = "mediatek,dramc_ch1_top3";
		reg = <0x0 0x10235000 0x0 0x1000>;
	};

	dramc_nao@1021d000 {
		compatible = "mediatek,dramc_nao";
		reg = <0x0 0x1021d000 0x0 0x1000>;
	};

	dsi0@14012000 {
		compatible = "mediatek,dsi0";
		interrupts = <0x0 0xd1 0x8>;
		reg = <0x0 0x14012000 0x0 0x1000>;
	};

	dsi_te {
		compatible = "mediatek, dsi_te-eint";
		linux,phandle = <0x6d>;
		phandle = <0x6d>;
		status = "disabled";
	};

	dvfsp@10227000 {
		compatible = "mediatek,dvfsp";
		interrupts = <0x0 0xa3 0x8>;
		reg = <0x0 0x10227000 0x0 0x1000>;
	};

	dvfsrc_top@10012000 {
		compatible = "mediatek,dvfsrc_top";
		reg = <0x0 0x10012000 0x0 0x1000>;
	};

	dxcc_sec@10210000 {
		compatible = "mediatek,dxcc_sec";
		interrupts = <0x0 0xa2 0x4>;
		reg = <0x0 0x10210000 0x0 0x1000>;
	};

	eem_fsm@1100b000 {
		clock-names = "CLK_TOP_MFG", "CLK_TOP_MFG_OFF", "CLK_TOP_MFG_ON", "CG_SCP_SYS_MFG0", "CG_SCP_SYS_MFG1";
		clocks = <0x25 0x2d 0x25 0x0 0x25 0x20 0x1a 0x0 0x1a 0x1>;
		compatible = "mediatek,eem_fsm";
		interrupts = <0x0 0x7d 0x8>;
		reg = <0x0 0x1100b000 0x0 0x1000>;
	};

	efuse_dbg@10004000 {
		compatible = "mediatek,efuse_dbg";
		reg = <0x0 0x10004000 0x0 0x1000>;
	};

	efusec@11c00000 {
		compatible = "mediatek,efusec";
		reg = <0x0 0x11c00000 0x0 0x10000>;
	};

	eint_acc {
		linux,phandle = <0x66>;
		phandle = <0x66>;
	};

	eint_alps {
		compatible = "mediatek, als-eint";
		linux,phandle = <0x65>;
		phandle = <0x65>;
	};

	eint_ctp {
		linux,phandle = <0x67>;
		phandle = <0x67>;
	};

	eint_ear {
		linux,phandle = <0x69>;
		phandle = <0x69>;
	};

	emi@10219000 {
		compatible = "mediatek,emi";
		interrupts = <0x0 0x90 0x8>;
		reg = <0x0 0x10219000 0x0 0x1000 0x0 0x1021a000 0x0 0x1000 0x0 0x10226000 0x0 0x1000>;
	};

	fhctl@1000ce00 {
		compatible = "mediatek,fhctl";
		reg = <0x0 0x1000ce00 0x0 0x0>;
	};

	firmware {

		android {
			compatible = "android,firmware";

			fstab {
				compatible = "android,fstab";

				bfr {
					compatible = "android,bfr";
					dev = "/dev/block/platform/bootdevice/by-name/bfr";
					fsmgr_flags = "defaults";
					mnt_flags = "defaults";
					status = "ok";
					type = "emmc";
				};

				bootfail_info {
					compatible = "android,bootfail_info";
					dev = "/dev/block/platform/bootdevice/by-name/bootfail_info";
					fsmgr_flags = "defaults";
					mnt_flags = "defaults";
					status = "ok";
					type = "emmc";
				};

				log {
					compatible = "android,log";
					dev = "/dev/block/platform/bootdevice/by-name/log";
					fsmgr_flags = " wait,check,formattable";
					mnt_flags = "rw";
					type = "ext4";
				};

				para {
					compatible = "android,para";
					dev = "/dev/block/platform/bootdevice/by-name/para";
					fsmgr_flags = "defaults";
					mnt_flags = "defaults";
					status = "ok";
					type = "emmc";
				};

				rrecord {
					compatible = "android,rrecord";
					dev = "/dev/block/platform/bootdevice/by-name/rrecord";
					fsmgr_flags = "defaults";
					mnt_flags = "defaults";
					status = "ok";
					type = "emmc";
				};

				system {
					compatible = "android,system";
					dev = "/dev/block/platform/bootdevice/by-name/system";
					fsmgr_flags = "wait,verify";
					mnt_flags = "ro";
					type = "ext4";
				};

				vendor {
					compatible = "android,vendor";
					dev = "/dev/block/platform/bootdevice/by-name/vendor";
					fsmgr_flags = "wait,verify";
					mnt_flags = "ro";
					type = "ext4";
				};
			};
		};
	};

	flashlight_core {
		compatible = "mediatek,flashlight_core";
		linux,phandle = <0x4f>;
		phandle = <0x4f>;
	};

	flashlights_aw3643 {
		compatible = "mediatek,flashlights_aw3643";
		linux,phandle = <0x51>;
		phandle = <0x51>;
	};

	flashlights_rt4505 {
		compatible = "mediatek,flashlights_rt4505";
		linux,phandle = <0x50>;
		phandle = <0x50>;
	};

	fp_int_n {
		linux,phandle = <0x64>;
		phandle = <0x64>;
	};

	gauge_timer {
		compatible = "mediatek,gauge_timer_service";
	};

	gce@10228000 {
		ap_dma_base = <0x18010000 0x17 0xffff0000>;
		audio_base = <0x17000000 0x12 0xffff0000>;
		buf_underrun_event_0 = <0x8c>;
		buf_underrun_event_1 = <0x8d>;
		camsv_1_pass1_done = <0x107>;
		camsv_2_pass1_done = <0x106>;
		camsys1_base = <0x180a0000 0x1c 0xffff0000>;
		camsys2_base = <0x180b0000 0x1d 0xffff0000>;
		camsys_base = <0x18080000 0x1b 0xffff0000>;
		clock-names = "GCE", "GCE_TIMER";
		clocks = <0x19 0x7 0x19 0x18>;
		compatible = "mediatek,gce";
		conn_peri_base = <0x18820000 0x7 0xffff0000>;
		disp_aal0_frame_done = <0x1c>;
		disp_aal0_sof = <0xb>;
		disp_ccorr0_frame_done = <0x1b>;
		disp_ccorr0_sof = <0xa>;
		disp_color0_frame_done = <0x1a>;
		disp_color0_sof = <0x9>;
		disp_dbi0_frame_done = <0x20>;
		disp_dbi0_sof = <0xf>;
		disp_dither0_frame_done = <0x1e>;
		disp_dither0_sof = <0xd>;
		disp_dither_base = <0x14010000 0x2 0xffff0000>;
		disp_dsi0_frame_done = <0x1f>;
		disp_dsi0_sof = <0xe>;
		disp_gamma0_frame_done = <0x1d>;
		disp_gamma0_sof = <0xc>;
		disp_ovl0 = <0x22>;
		disp_ovl0_frame_done = <0x18>;
		disp_ovl0_frame_rst_done_pusle = <0x99>;
		disp_ovl0_sof = <0x6>;
		disp_pwm0_sof = <0x10>;
		disp_rdma0_frame_done = <0x11>;
		disp_rdma0_sof = <0x7>;
		disp_wdma0_frame_done = <0x19>;
		disp_wdma0_rst_done = <0x94>;
		disp_wdma0_sof = <0x8>;
		dsi0_done_event = <0x90>;
		dsi0_irq_event = <0x8f>;
		dsi0_te_event = <0x8e>;
		g3d_config_base = <0x13000000 0x0 0xffff0000>;
		gce_base = <0x18020000 0x18 0xffff0000>;
		gcpu_base = <0x10050000 0xf 0xffff0000>;
		imgsys_base = <0x15020000 0x4 0xffff0000>;
		infra_na3_base = <0x10010000 0xb 0xffff0000>;
		infra_na4_base = <0x10020000 0xc 0xffff0000>;
		interrupts = <0x0 0x9a 0x8 0x0 0x9b 0x8>;
		isp_frame_done_p1_0 = <0x105>;
		isp_frame_done_p1_1 = <0x104>;
		isp_frame_done_p2_0 = <0x103>;
		isp_frame_done_p2_1 = <0x102>;
		isp_frame_done_p2_2 = <0x101>;
		jpgdec_done = <0x123>;
		jpgenc_done = <0x122>;
		kp_base = <0x18840000 0x9 0xffff0000>;
		max_prefetch_cnt = <0x1>;
		mcucfg_base = <0x10040000 0xe 0xffff0000>;
		mdp_rdma0 = <0x1c>;
		mdp_rdma0_frame_done = <0x12>;
		mdp_rdma0_rst_done = <0x98>;
		mdp_rdma0_sof = <0x0>;
		mdp_rsz0 = <0x1d>;
		mdp_rsz0_frame_done = <0x13>;
		mdp_rsz0_sof = <0x1>;
		mdp_rsz1 = <0x1e>;
		mdp_rsz1_frame_done = <0x14>;
		mdp_rsz1_sof = <0x2>;
		mdp_tdshp0 = <0x21>;
		mdp_tdshp_frame_done = <0x15>;
		mdp_tdshp_sof = <0x5>;
		mdp_wdma0 = <0x1f>;
		mdp_wdma_frame_done = <0x17>;
		mdp_wdma_rst_done = <0x95>;
		mdp_wdma_sof = <0x3>;
		mdp_wrot0 = <0x20>;
		mdp_wrot0_rst_done = <0x96>;
		mdp_wrot0_sof = <0x4>;
		mdp_wrot0_write_frame_done = <0x16>;
		mm_mutex = <0x23>;
		mm_na_base = <0x14020000 0x3 0xffff0000>;
		mmsys_config = <0x1b>;
		mmsys_config_base = <0x14000000 0x1 0xffff0000>;
		msdc2_base = <0x17020000 0x14 0xffff0000>;
		msdc3_base = <0x18000000 0x16 0xffff0000>;
		prefetch_size = <0x60>;
		pwm_sw_base = <0x11000000 0x63 0xffff0000>;
		reg = <0x0 0x10228000 0x0 0x4000>;
		scp_base = <0x10030000 0xd 0xffff0000>;
		scp_sram_base = <0x10000000 0xa 0xffff0000>;
		seninf_cam0_fifo_full = <0x109>;
		seninf_cam1_2_3_fifo_full = <0x108>;
		sram_share_cnt = <0x1>;
		sram_share_engine = <0x8>;
		sram_share_event = <0x1e0>;
		sram_size_cpr_64 = <0x40>;
		stream_done_0 = <0x82>;
		stream_done_1 = <0x83>;
		stream_done_2 = <0x84>;
		stream_done_3 = <0x85>;
		stream_done_4 = <0x86>;
		stream_done_5 = <0x87>;
		stream_done_6 = <0x88>;
		stream_done_7 = <0x89>;
		stream_done_8 = <0x8a>;
		stream_done_9 = <0x8b>;
		topckgen_base = <0x18830000 0x8 0xffff0000>;
		usb0_base = <0x10200000 0x10 0xffff0000>;
		usb_sif_base = <0x10280000 0x11 0xffff0000>;
		vdec1_base = <0x17030000 0x15 0xffff0000>;
		vdec2_base = <0x18040000 0x19 0xffff0000>;
		vdec3_base = <0x18050000 0x1a 0xffff0000>;
		vdec_base = <0x17010000 0x13 0xffff0000>;
		vdec_gcon_base = <0x18800000 0x5 0xffff0000>;
		venc_128byte_cnt_done = <0x125>;
		venc_done = <0x121>;
		venc_gcon_base = <0x18810000 0x6 0xffff0000>;
		venc_mb_done = <0x124>;
	};

	gic500@0c000000 {
		compatible = "mediatek,gic500";
		reg = <0x0 0xc000000 0x0 0x0>;
	};

	gic_cpu@0c400000 {
		compatible = "mediatek,gic_cpu";
		reg = <0x0 0xc400000 0x0 0x40000>;
	};

	gpio {
		compatible = "mediatek,gpio_usage_mapping";
		linux,phandle = <0x3b>;
		phandle = <0x3b>;
	};

	gpio@10005000 {
		compatible = "mediatek,gpio";
		linux,phandle = <0x3c>;
		phandle = <0x3c>;
		reg = <0x0 0x10005000 0x0 0x1000>;
	};

	gps {
		compatible = "mediatek,gps";
	};

	gpufreq {
		clock-names = "CLK_TOP_MFG", "CLK_TOP_MFG_OFF", "CLK_TOP_MFG_ON";
		clocks = <0x25 0x2d 0x26 0x25 0x20>;
		compatible = "mediatek,mt6739-gpufreq";
	};

	gse_1 {
		linux,phandle = <0x5f>;
		phandle = <0x5f>;
	};

	gyro {
		compatible = "mediatek,gyroscope";
		linux,phandle = <0x61>;
		phandle = <0x61>;
	};

	hacc@1000a000 {
		compatible = "mediatek,hacc";
		interrupts = <0x0 0xb5 0x8>;
		reg = <0x0 0x1000a000 0x0 0x1000>;
	};

	huawei_charger {
		bms_power_supply = "charger";
		compatible = "huawei,charger";
	};

	huawei_fuelguage {
		bms_power_supply = "charger";
		compatible = "huawei,fuelguage";
		status = "okay";
	};

	i2c@11007000 {
		aed = <0x1f>;
		clock-div = <0x5>;
		clock-names = "main", "dma";
		clocks = <0x19 0x9 0x19 0x28>;
		compatible = "mediatek,mt6739-i2c";
		id = <0x0>;
		interrupts = <0x0 0x54 0x8>;
		linux,phandle = <0x42>;
		phandle = <0x42>;
		reg = <0x0 0x11007000 0x0 0x1000 0x0 0x11000100 0x0 0x80>;
	};

	i2c@11008000 {
		aed = <0x1f>;
		clock-div = <0x5>;
		clock-names = "main", "dma";
		clocks = <0x19 0xa 0x19 0x28>;
		compatible = "mediatek,mt6739-i2c";
		id = <0x1>;
		interrupts = <0x0 0x55 0x8>;
		linux,phandle = <0x43>;
		phandle = <0x43>;
		reg = <0x0 0x11008000 0x0 0x1000 0x0 0x11000180 0x0 0x80>;

		rt9458@6a {
			aicr = <0x7a120>;
			charger_name = "primary_chg";
			compatible = "richtek,rt9458";
			cv = <0x426030>;
			enable_eoc_shdn;
			enable_te;
			ichg = <0x17a6b0>;
			ieoc = <0x30d40>;
			mivr = <0x44aa20>;
			reg = <0x6a>;
			rt,intr_gpio = <0x24 0x19 0x0>;
			rt,intr_gpio_num = <0x19>;
			status = "okay";
			vmreg = <0x426030>;
		};
	};

	i2c@11009000 {
		aed = <0x1f>;
		clock-div = <0x5>;
		clock-names = "main", "dma";
		clocks = <0x19 0xb 0x19 0x28>;
		compatible = "mediatek,mt6739-i2c";
		id = <0x2>;
		interrupts = <0x0 0x56 0x8>;
		linux,phandle = <0x44>;
		phandle = <0x44>;
		reg = <0x0 0x11009000 0x0 0x1000 0x0 0x11000200 0x0 0x80>;
	};

	i2c@1100f000 {
		aed = <0x1f>;
		clock-div = <0x5>;
		clock-names = "main", "dma";
		clocks = <0x19 0xc 0x19 0x28>;
		compatible = "mediatek,mt6739-i2c";
		id = <0x3>;
		interrupts = <0x0 0x57 0x8>;
		linux,phandle = <0x45>;
		phandle = <0x45>;
		reg = <0x0 0x1100f000 0x0 0x1000 0x0 0x11000280 0x0 0x80>;
	};

	i2c@11011000 {
		aed = <0x1f>;
		clock-div = <0x5>;
		clock-names = "main", "dma";
		clocks = <0x19 0x37 0x19 0x28>;
		compatible = "mediatek,mt6739-i2c";
		id = <0x4>;
		interrupts = <0x0 0x58 0x8>;
		linux,phandle = <0x46>;
		phandle = <0x46>;
		reg = <0x0 0x11011000 0x0 0x1000 0x0 0x11000300 0x0 0x80>;
	};

	i2c@11016000 {
		aed = <0x1f>;
		clock-div = <0x5>;
		clock-names = "main", "dma";
		clocks = <0x19 0x3b 0x19 0x28>;
		compatible = "mediatek,mt6739-i2c";
		id = <0x5>;
		interrupts = <0x0 0x82 0x8>;
		linux,phandle = <0x47>;
		phandle = <0x47>;
		reg = <0x0 0x11016000 0x0 0x1000 0x0 0x11000380 0x0 0x80>;
	};

	imgsys_config@15000000 {
		#clock-cells = <0x1>;
		compatible = "mediatek,imgsys", "syscon";
		linux,phandle = <0x36>;
		phandle = <0x36>;
		reg = <0x0 0x15000000 0x0 0x1000>;
	};

	infra_mbist@1020d000 {
		compatible = "mediatek,infra_mbist";
		reg = <0x0 0x1020d000 0x0 0x1000>;
	};

	infracfg@1020e000 {
		compatible = "mediatek,infracfg";
		reg = <0x0 0x1020e000 0x0 0x1000>;
	};

	infracfg_ao@10001000 {
		#clock-cells = <0x1>;
		compatible = "mediatek,infracfg_ao", "syscon";
		interrupts = <0x0 0x93 0x1>;
		linux,phandle = <0x19>;
		phandle = <0x19>;
		reg = <0x0 0x10001000 0x0 0x1000>;
	};

	int_sar_sensor {
		compatible = "mediatek, sar-eint";
		linux,phandle = <0x68>;
		phandle = <0x68>;
	};

	interrupt-controller@0c000000 {
		#address-cells = <0x2>;
		#interrupt-cells = <0x3>;
		#redistributor-regions = <0x1>;
		#size-cells = <0x2>;
		compatible = "arm,gic-v3";
		interrupt-controller;
		interrupt-parent = <0x2>;
		interrupts = <0x1 0x9 0x4>;
		linux,phandle = <0x2>;
		mediatek,reg_len_pol0 = <0x8>;
		phandle = <0x2>;
		reg = <0x0 0xc000000 0x0 0x40000 0x0 0xc080000 0x0 0x200000 0x0 0x10200620 0x0 0x1000>;
	};

	intpol-controller@0x10200620 {
		#interrupt-cells = <0x3>;
		compatible = "mediatek,mt6739-sysirq", "mediatek,mt6577-sysirq";
		interrupt-controller;
		interrupt-parent = <0x2>;
		linux,phandle = <0x1>;
		phandle = <0x1>;
		reg = <0x0 0x10200620 0x0 0x20>;
	};

	io_cfg_bl@10002600 {
		compatible = "mediatek,io_cfg_bl";
		reg = <0x0 0x10002600 0x0 0x200>;
	};

	io_cfg_bm@10002800 {
		compatible = "mediatek,io_cfg_bm";
		reg = <0x0 0x10002800 0x0 0x200>;
	};

	io_cfg_lb@10002400 {
		compatible = "mediatek,io_cfg_lb";
		reg = <0x0 0x10002400 0x0 0x200>;
	};

	io_cfg_lm@10002200 {
		compatible = "mediatek,io_cfg_lm";
		reg = <0x0 0x10002200 0x0 0x200>;
	};

	io_cfg_lt@10002000 {
		compatible = "mediatek,io_cfg_lt";
		reg = <0x0 0x10002000 0x0 0x200>;
	};

	io_cfg_rb@10002a00 {
		compatible = "mediatek,io_cfg_rb";
		reg = <0x0 0x10002a00 0x0 0x200>;
	};

	io_cfg_rt@10002c00 {
		compatible = "mediatek,io_cfg_rt";
		reg = <0x0 0x10002c00 0x0 0x200>;
	};

	iocfg_0@10002000 {
		compatible = "mediatek,iocfg_0";
		reg = <0x0 0x10002000 0x0 0x200>;
	};

	iocfg_1@10002200 {
		compatible = "mediatek,iocfg_1";
		reg = <0x0 0x10002200 0x0 0x200>;
	};

	iocfg_2@10002400 {
		compatible = "mediatek,iocfg_2";
		reg = <0x0 0x10002400 0x0 0x200>;
	};

	iocfg_3@10002600 {
		compatible = "mediatek,iocfg_3";
		reg = <0x0 0x10002600 0x0 0x200>;
	};

	iocfg_4@10002800 {
		compatible = "mediatek,iocfg_4";
		reg = <0x0 0x10002800 0x0 0x200>;
	};

	iocfg_5@10002a00 {
		compatible = "mediatek,iocfg_5";
		reg = <0x0 0x10002a00 0x0 0x200>;
	};

	irq_nfc {
		compatible = "mediatek,irq_nfc-eint";
		linux,phandle = <0x75>;
		phandle = <0x75>;
	};

	irtx@1100d000 {
		compatible = "mediatek,irtx";
		interrupts = <0x0 0x7f 0x8>;
		reg = <0x0 0x1100d000 0x0 0x1000>;
	};

	irtx_pwm {
		compatible = "mediatek,irtx-pwm";
		linux,phandle = <0x78>;
		phandle = <0x78>;
		pwm_ch = <0x1>;
		pwm_data_invert = <0x0>;
	};

	ispsys@15000000 {
		clock-names = "CG_SCP_SYS_MM0", "CG_SCP_SYS_ISP", "CG_IMG_CAM_SMI", "CG_IMG_CAM_CAM", "CG_IMG_SEN_TG", "CG_IMG_SEN_CAM", "CG_IMG_CAM_SV";
		clocks = <0x1a 0x4 0x1a 0x5 0x36 0x1 0x36 0x2 0x36 0x3 0x36 0x4 0x36 0x5>;
		compatible = "mediatek,mt6739-ispsys";
		interrupts = <0x0 0xd9 0x8 0x0 0xda 0x8 0x0 0xdb 0x8 0x0 0xdc 0x8 0x0 0xdd 0x8>;
		reg = <0x0 0x15004000 0x0 0x9000 0x0 0x1500d000 0x0 0x1000 0x0 0x15000000 0x0 0x10000 0x0 0x10215000 0x0 0x3000 0x0 0x10211000 0x0 0x1000>;
	};

	kd_camera_hw1@15008000 {
		clock-names = "CLK_TOP_CAMTG_SEL", "CLK_TOP_CAMTG2_SEL", "CLK_TOP_CLK26M", "CLK_TOP_UNIVPLL_48M_D2", "CLK_TOP_UNIVPLL2_D8", "CLK_TOP_UNIVPLL_D26", "CLK_TOP_UNIVPLL2_D32", "CLK_TOP_UNIVPLL_48M_D4", "CLK_TOP_UNIVPLL_48M_D8", "CLK_TOP_SENINF_SEL", "CLK_TOP_SCAM_SEL";
		clocks = <0x25 0x2e 0x25 0x41 0x26 0x25 0x11 0x25 0x1a 0x25 0x10 0x25 0x1b 0x25 0x12 0x25 0x13 0x25 0x3f 0x25 0x37>;
		compatible = "mediatek,camera_hw";
		linux,phandle = <0x6e>;
		phandle = <0x6e>;
		reg = <0x0 0x15008000 0x0 0x1000>;
	};

	kp@10010000 {
		compatible = "mediatek,kp";
		interrupts = <0x0 0xb0 0x2>;
		linux,phandle = <0x16>;
		phandle = <0x16>;
		reg = <0x0 0x10010000 0x0 0x1000>;
	};

	led_simple {
		compatible = "mt65xx_leds";
		linux,phandle = <0x59>;
		phandle = <0x59>;
	};

	m4u@10205000 {
		cell-index = <0x0>;
		compatible = "mediatek,m4u";
		interrupts = <0x0 0x9e 0x8>;
		reg = <0x0 0x10205000 0x0 0x1000>;
	};

	mbist_ao@10013000 {
		compatible = "mediatek,mbist_ao";
		reg = <0x0 0x10013000 0x0 0x1000>;
	};

	mcdi@10216000 {
		compatible = "mediatek,mt6739-mcdi";
		reg = <0x0 0x10fc00 0x0 0x400 0x0 0x10216000 0x0 0x1000 0x0 0x10217000 0x0 0x2000>;
	};

	mcucfg@10200000 {
		compatible = "mediatek,mcucfg";
		interrupts = <0x0 0x0 0x8>;
		reg = <0x0 0x10200000 0x0 0x1000>;
	};

	md1_sim1_hot_plug_eint {
		linux,phandle = <0x76>;
		phandle = <0x76>;
	};

	md1_sim2_hot_plug_eint {
		linux,phandle = <0x77>;
		phandle = <0x77>;
	};

	md2md_md1_ccif0@10211000 {
		compatible = "mediatek,md2md_md1_ccif0";
		reg = <0x0 0x10211000 0x0 0x1000>;
	};

	md2md_md2_ccif0@10213000 {
		compatible = "mediatek,md2md_md2_ccif0";
		reg = <0x0 0x10213000 0x0 0x1000>;
	};

	md_ccif0@1020a000 {
		compatible = "mediatek,md_ccif0";
		reg = <0x0 0x1020a000 0x0 0x1000>;
	};

	md_ccif1@1020c000 {
		compatible = "mediatek,md_ccif1";
		reg = <0x0 0x1020c000 0x0 0x1000>;
	};

	mdcldma@10014000 {
		clock-names = "scp-sys-md1-main", "infra-cldma-bclk", "infra-ccif-ap", "infra-ccif-md", "infra-ccif1-ap", "infra-ccif1-md";
		clocks = <0x1a 0x2 0x19 0x34 0x19 0x2b 0x19 0x2e 0x19 0x24 0x19 0x25>;
		compatible = "mediatek,mdcldma";
		interrupts = <0x0 0xa5 0x4 0x0 0x94 0x8 0x0 0x95 0x8 0x0 0xe3 0x2>;
		linux,phandle = <0x17>;
		mediatek,cldma_capability = <0x6>;
		mediatek,md_id = <0x0>;
		phandle = <0x17>;
		reg = <0x0 0x10014000 0x0 0x1000 0x0 0x1021b000 0x0 0x1000 0x0 0x10209000 0x0 0x1000 0x0 0x1020a000 0x0 0x1000>;
	};

	mdcldmain@1021c000 {
		compatible = "mediatek,mdcldmain";
		reg = <0x0 0x1021c000 0x0 0x400>;
	};

	mdcldmain_ao@10015000 {
		compatible = "mediatek,mdcldmain_ao";
		reg = <0x0 0x10015000 0x0 0x400>;
	};

	mdcldmamisc@1021c000 {
		compatible = "mediatek,mdcldmamisc";
		reg = <0x0 0x1021c000 0x0 0x0>;
	};

	mdcldmamisc@1021c900 {
		compatible = "mediatek,mdcldmamisc";
		reg = <0x0 0x1021c900 0x0 0x400>;
	};

	mdcldmamisc_ao@10015800 {
		compatible = "mediatek,mdcldmamisc_ao";
		reg = <0x0 0x10015800 0x0 0x400>;
	};

	mdcldmaout@1021c400 {
		compatible = "mediatek,mdcldmaout";
		reg = <0x0 0x1021c400 0x0 0x400>;
	};

	mdcldmaout_ao@10015400 {
		compatible = "mediatek,mdcldmaout_ao";
		reg = <0x0 0x10015400 0x0 0x400>;
	};

	mdp_rdma0@14004000 {
		clock-names = "MDP_RDMA0";
		clocks = <0x1b 0x5>;
		compatible = "mediatek,mdp_rdma0";
		interrupts = <0x0 0xc3 0x8>;
		linux,phandle = <0x1c>;
		phandle = <0x1c>;
		reg = <0x0 0x14004000 0x0 0x1000>;
	};

	mdp_rsz0@14005000 {
		clock-names = "MDP_RSZ0";
		clocks = <0x1b 0x6>;
		compatible = "mediatek,mdp_rsz0";
		interrupts = <0x0 0xc4 0x8>;
		linux,phandle = <0x1d>;
		phandle = <0x1d>;
		reg = <0x0 0x14005000 0x0 0x1000>;
	};

	mdp_rsz1@14006000 {
		clock-names = "MDP_RSZ1";
		clocks = <0x1b 0x7>;
		compatible = "mediatek,mdp_rsz1";
		interrupts = <0x0 0xc5 0x8>;
		linux,phandle = <0x1e>;
		phandle = <0x1e>;
		reg = <0x0 0x14006000 0x0 0x1000>;
	};

	mdp_tdshp0@14009000 {
		clock-names = "MDP_TDSHP";
		clocks = <0x1b 0x8>;
		compatible = "mediatek,mdp_tdshp0";
		linux,phandle = <0x21>;
		phandle = <0x21>;
		reg = <0x0 0x14009000 0x0 0x1000>;
	};

	mdp_wdma0@14007000 {
		clock-names = "MDP_WDMA";
		clocks = <0x1b 0xa>;
		compatible = "mediatek,mdp_wdma0";
		interrupts = <0x0 0xc8 0x8>;
		linux,phandle = <0x1f>;
		phandle = <0x1f>;
		reg = <0x0 0x14007000 0x0 0x1000>;
	};

	mdp_wrot0@14008000 {
		clock-names = "MDP_WROT0";
		clocks = <0x1b 0x9>;
		compatible = "mediatek,mdp_wrot0";
		interrupts = <0x0 0xc7 0x8>;
		linux,phandle = <0x20>;
		phandle = <0x20>;
		reg = <0x0 0x14008000 0x0 0x1000>;
	};

	memory {
		device_type = "memory";
		reg = <0x0 0x40000000 0x0 0x20000000>;
	};

	mfg_auckland@13000000 {
		clock-frequency = <0x21f98280>;
		clock-names = "CLK_TOP_MFG", "CLK_TOP_MFG_OFF", "CLK_TOP_MFG_ON", "CG_SCP_SYS_MFG0", "CG_SCP_SYS_MFG1";
		clocks = <0x25 0x2d 0x26 0x25 0x20 0x1a 0x0 0x1a 0x1>;
		compatible = "mediatek,AUCKLAND";
		interrupt-names = "RGX";
		interrupts = <0x0 0xe2 0x8>;
		reg = <0x0 0x13000000 0x0 0x80000>;
	};

	mfg_cfg@13ffe000 {
		compatible = "mediatek,mt6739-mfg_cfg", "syscon";
		reg = <0x0 0x13ffe000 0x0 0x1000>;
	};

	mipi_rx_ana_csi0@11c10000 {
		compatible = "mediatek,mipi_rx_ana_csi0";
		reg = <0x0 0x11c10000 0x0 0x10000>;
	};

	mipi_rx_ana_csi1@11c20000 {
		compatible = "mediatek,mipi_rx_ana_csi1";
		reg = <0x0 0x11c20000 0x0 0x10000>;
	};

	mipi_tx0@11c80000 {
		compatible = "mediatek,mipi_tx0";
		reg = <0x0 0x11c80000 0x0 0x1000>;
	};

	mm_mutex@14016000 {
		compatible = "mediatek,mm_mutex";
		linux,phandle = <0x55>;
		phandle = <0x55>;
		reg = <0x0 0x14016000 0x0 0x0>;
	};

	mmsys_config@14000000 {
		#clock-cells = <0x1>;
		clock-names = "CAM_MDP";
		clocks = <0x1b 0x4>;
		compatible = "mediatek,mmsys_config", "syscon";
		interrupts = <0x0 0xd3 0x8>;
		linux,phandle = <0x1b>;
		phandle = <0x1b>;
		reg = <0x0 0x14000000 0x0 0x1000>;
	};

	mobicore {
		compatible = "trustonic,mobicore";
		interrupts = <0x0 0x6e 0x1>;
	};

	modem_temp_share@10018000 {
		compatible = "mediatek,modem_temp_share";
		reg = <0x0 0x10018000 0x0 0x1000>;
	};

	mrdump_ext_rst {
		compatible = "mediatek, mrdump_ext_rst-eint";
		linux,phandle = <0x62>;
		mode = "IRQ";
		phandle = <0x62>;
		source = "EINT";
		status = "okay";
	};

	msdc0_pad_macro@11cd0000 {
		compatible = "mediatek,msdc0_pad_macro";
		reg = <0x0 0x11cd0000 0x0 0x10000>;
	};

	msdc1_ins {
		linux,phandle = <0x63>;
		phandle = <0x63>;
	};

	msdc1_pad_macro@11c40000 {
		compatible = "mediatek,msdc1_pad_macro";
		reg = <0x0 0x11c40000 0x0 0x10000>;
	};

	msdc@11230000 {
		bus-width = <0x8>;
		cap-mmc-highspeed;
		clk_src = [01];
		clock-names = "msdc0-clock", "msdc0-hclock";
		clocks = <0x19 0x4b 0x19 0x1c>;
		compatible = "mediatek,msdc";
		host_function = [00];
		hw_dvfs = [00];
		index = [00];
		interrupts = <0x0 0x4f 0x8>;
		linux,phandle = <0x4b>;
		max-frequency = <0xbebc200>;
		mmc-ddr-1_8v;
		mmc-hs200-1_8v;
		mmc-hs400-1_8v;
		msdc-sys-suspend;
		non-removable;
		phandle = <0x4b>;
		pinctl = <0x27>;
		reg = <0x0 0x11230000 0x0 0x10000 0x0 0x11cd0000 0x0 0x10000>;
		register_setting = <0x28>;
		status = "okay";
		vmmc-supply = <0x29>;

		msdc0@default {
			linux,phandle = <0x27>;
			phandle = <0x27>;

			pins_clk {
				drive-strength = [04];
			};

			pins_cmd {
				drive-strength = [04];
			};

			pins_dat {
				drive-strength = [04];
			};

			pins_ds {
				drive-strength = [04];
			};

			pins_rst {
				drive-strength = [04];
			};
		};

		msdc0@register_default {
			cmd_edge = [00];
			linux,phandle = <0x28>;
			phandle = <0x28>;
			rdata_edge = [00];
			wdata_edge = [00];
		};
	};

	msdc@11240000 {
		bus-width = <0x4>;
		cap-sd-highspeed;
		cd-gpios = <0x24 0xf 0x0>;
		cd_level = [01];
		clk_src = [02];
		clock-names = "msdc1-clock", "msdc1-hclock";
		clocks = <0x19 0x4c 0x19 0x1d>;
		compatible = "mediatek,msdc";
		host_function = [01];
		hw_dvfs = [00];
		index = [01];
		interrupts = <0x0 0x50 0x8>;
		linux,phandle = <0x4c>;
		max-frequency = <0xbebc200>;
		msdc-sys-suspend;
		phandle = <0x4c>;
		pinctl = <0x2a>;
		pinctl_ddr50 = <0x2d>;
		pinctl_sdr104 = <0x2b>;
		pinctl_sdr50 = <0x2c>;
		reg = <0x0 0x11240000 0x0 0x10000 0x0 0x11c40000 0x0 0x10000>;
		register_setting = <0x2e>;
		sd-uhs-ddr50;
		sd-uhs-sdr104;
		sd-uhs-sdr12;
		sd-uhs-sdr25;
		sd-uhs-sdr50;
		status = "okay";
		vmmc-supply = <0x2f>;
		vqmmc-supply = <0x30>;

		msdc1@ddr50 {
			linux,phandle = <0x2d>;
			phandle = <0x2d>;

			pins_clk {
				drive-strength = [03];
			};

			pins_cmd {
				drive-strength = [03];
			};

			pins_dat {
				drive-strength = [03];
			};
		};

		msdc1@default {
			linux,phandle = <0x2a>;
			phandle = <0x2a>;

			pins_clk {
				drive-strength = [03];
			};

			pins_cmd {
				drive-strength = [03];
			};

			pins_dat {
				drive-strength = [03];
			};
		};

		msdc1@register_default {
			cmd_edge = [00];
			linux,phandle = <0x2e>;
			phandle = <0x2e>;
			rdata_edge = [00];
			wdata_edge = [00];
		};

		msdc1@sdr104 {
			linux,phandle = <0x2b>;
			phandle = <0x2b>;

			pins_clk {
				drive-strength = [03];
			};

			pins_cmd {
				drive-strength = [03];
			};

			pins_dat {
				drive-strength = [03];
			};
		};

		msdc1@sdr50 {
			linux,phandle = <0x2c>;
			phandle = <0x2c>;

			pins_clk {
				drive-strength = [03];
			};

			pins_cmd {
				drive-strength = [03];
			};

			pins_dat {
				drive-strength = [03];
			};
		};
	};

	mse {
		linux,phandle = <0x60>;
		phandle = <0x60>;
	};

	mt6357_gauge {
		alias_name = "mt6357";
		compatible = "mediatek,mt6357_gauge";
		gauge_name = "gauge";
	};

	mt_charger {
		compatible = "mediatek,mt-charger";
		linux,phandle = <0x58>;
		phandle = <0x58>;
	};

	mt_pmic_regulator {
		compatible = "mediatek,mt_pmic";

		buck_regulators {
			compatible = "mediatek,mt_pmic_buck_regulators";

			buck_vcore {
				linux,phandle = <0x7c>;
				phandle = <0x7c>;
				regulator-enable-ramp-delay = <0xdc>;
				regulator-max-microvolt = <0x1406f4>;
				regulator-min-microvolt = <0x7ea5e>;
				regulator-name = "vcore";
				regulator-ramp-delay = <0x186a>;
			};

			buck_vmodem {
				linux,phandle = <0x7b>;
				phandle = <0x7b>;
				regulator-enable-ramp-delay = <0xdc>;
				regulator-max-microvolt = <0x123716>;
				regulator-min-microvolt = <0x7a120>;
				regulator-name = "vmodem";
				regulator-ramp-delay = <0x186a>;
			};

			buck_vpa {
				linux,phandle = <0x7e>;
				phandle = <0x7e>;
				regulator-enable-ramp-delay = <0xdc>;
				regulator-max-microvolt = <0x37b1d0>;
				regulator-min-microvolt = <0x7a120>;
				regulator-name = "vpa";
				regulator-ramp-delay = <0xc350>;
			};

			buck_vproc {
				linux,phandle = <0x7d>;
				phandle = <0x7d>;
				regulator-enable-ramp-delay = <0xdc>;
				regulator-max-microvolt = <0x1406f4>;
				regulator-min-microvolt = <0x7ea5e>;
				regulator-name = "vproc";
				regulator-ramp-delay = <0x186a>;
			};

			buck_vs1 {
				linux,phandle = <0x7a>;
				phandle = <0x7a>;
				regulator-enable-ramp-delay = <0xdc>;
				regulator-max-microvolt = <0x2191c0>;
				regulator-min-microvolt = <0x124f80>;
				regulator-name = "vs1";
				regulator-ramp-delay = <0x30d4>;
			};
		};

		ldo_regulators {
			compatible = "mediatek,mt_pmic_ldo_regulators";

			ldo_vaud28 {
				compatible = "regulator-fixed";
				linux,phandle = <0x8f>;
				phandle = <0x8f>;
				regulator-enable-ramp-delay = <0x108>;
				regulator-max-microvolt = <0x2ab980>;
				regulator-min-microvolt = <0x2ab980>;
				regulator-name = "vaud28";
			};

			ldo_vaux18 {
				compatible = "regulator-fixed";
				linux,phandle = <0x8e>;
				phandle = <0x8e>;
				regulator-enable-ramp-delay = <0x108>;
				regulator-max-microvolt = <0x1b7740>;
				regulator-min-microvolt = <0x1b7740>;
				regulator-name = "vaux18";
			};

			ldo_vcama {
				linux,phandle = <0x88>;
				phandle = <0x88>;
				regulator-enable-ramp-delay = <0x108>;
				regulator-max-microvolt = <0x2ab980>;
				regulator-min-microvolt = <0x2625a0>;
				regulator-name = "vcama";
			};

			ldo_vcamd {
				linux,phandle = <0x89>;
				phandle = <0x89>;
				regulator-enable-ramp-delay = <0x108>;
				regulator-max-microvolt = <0x1b7740>;
				regulator-min-microvolt = <0xf4240>;
				regulator-name = "vcamd";
			};

			ldo_vcamio {
				compatible = "regulator-fixed";
				linux,phandle = <0x8a>;
				phandle = <0x8a>;
				regulator-enable-ramp-delay = <0x108>;
				regulator-max-microvolt = <0x1b7740>;
				regulator-min-microvolt = <0x1b7740>;
				regulator-name = "vcamio";
			};

			ldo_vcn18 {
				compatible = "regulator-fixed";
				linux,phandle = <0x87>;
				phandle = <0x87>;
				regulator-enable-ramp-delay = <0x108>;
				regulator-max-microvolt = <0x1b7740>;
				regulator-min-microvolt = <0x1b7740>;
				regulator-name = "vcn18";
			};

			ldo_vcn28 {
				compatible = "regulator-fixed";
				linux,phandle = <0x86>;
				phandle = <0x86>;
				regulator-enable-ramp-delay = <0x108>;
				regulator-max-microvolt = <0x2ab980>;
				regulator-min-microvolt = <0x2ab980>;
				regulator-name = "vcn28";
			};

			ldo_vcn33_bt {
				linux,phandle = <0x84>;
				phandle = <0x84>;
				regulator-enable-ramp-delay = <0x108>;
				regulator-max-microvolt = <0x3567e0>;
				regulator-min-microvolt = <0x325aa0>;
				regulator-name = "vcn33_bt";
			};

			ldo_vcn33_wifi {
				linux,phandle = <0x85>;
				phandle = <0x85>;
				regulator-enable-ramp-delay = <0x108>;
				regulator-max-microvolt = <0x3567e0>;
				regulator-min-microvolt = <0x325aa0>;
				regulator-name = "vcn33_wifi";
			};

			ldo_vdram {
				linux,phandle = <0x92>;
				phandle = <0x92>;
				regulator-enable-ramp-delay = <0xce4>;
				regulator-max-microvolt = <0x124f80>;
				regulator-min-microvolt = <0x10c8e0>;
				regulator-name = "vdram";
			};

			ldo_vefuse {
				linux,phandle = <0x83>;
				phandle = <0x83>;
				regulator-enable-ramp-delay = <0x108>;
				regulator-max-microvolt = <0x325aa0>;
				regulator-min-microvolt = <0x124f80>;
				regulator-name = "vefuse";
			};

			ldo_vemc {
				linux,phandle = <0x29>;
				phandle = <0x29>;
				regulator-enable-ramp-delay = <0x2c>;
				regulator-max-microvolt = <0x325aa0>;
				regulator-min-microvolt = <0x2c4020>;
				regulator-name = "vemc";
			};

			ldo_vfe28 {
				compatible = "regulator-fixed";
				linux,phandle = <0x7f>;
				phandle = <0x7f>;
				regulator-enable-ramp-delay = <0x108>;
				regulator-max-microvolt = <0x2ab980>;
				regulator-min-microvolt = <0x2ab980>;
				regulator-name = "vfe28";
			};

			ldo_vibr {
				linux,phandle = <0x95>;
				phandle = <0x95>;
				regulator-enable-ramp-delay = <0x2c>;
				regulator-max-microvolt = <0x325aa0>;
				regulator-min-microvolt = <0x124f80>;
				regulator-name = "vibr";
			};

			ldo_vio18 {
				compatible = "regulator-fixed";
				linux,phandle = <0x91>;
				phandle = <0x91>;
				regulator-enable-ramp-delay = <0x108>;
				regulator-max-microvolt = <0x1b7740>;
				regulator-min-microvolt = <0x1b7740>;
				regulator-name = "vio18";
			};

			ldo_vio28 {
				compatible = "regulator-fixed";
				linux,phandle = <0x90>;
				phandle = <0x90>;
				regulator-enable-ramp-delay = <0x108>;
				regulator-max-microvolt = <0x2ab980>;
				regulator-min-microvolt = <0x2ab980>;
				regulator-name = "vio28";
			};

			ldo_vldo28 {
				linux,phandle = <0x8b>;
				phandle = <0x8b>;
				regulator-enable-ramp-delay = <0x108>;
				regulator-max-microvolt = <0x2dc6c0>;
				regulator-min-microvolt = <0x2ab980>;
				regulator-name = "vldo28";
			};

			ldo_vmc {
				linux,phandle = <0x30>;
				phandle = <0x30>;
				regulator-enable-ramp-delay = <0x2c>;
				regulator-max-microvolt = <0x325aa0>;
				regulator-min-microvolt = <0x1b7740>;
				regulator-name = "vmc";
			};

			ldo_vmch {
				linux,phandle = <0x2f>;
				phandle = <0x2f>;
				regulator-enable-ramp-delay = <0x2c>;
				regulator-max-microvolt = <0x325aa0>;
				regulator-min-microvolt = <0x2c4020>;
				regulator-name = "vmch";
			};

			ldo_vrf12 {
				compatible = "regulator-fixed";
				linux,phandle = <0x82>;
				phandle = <0x82>;
				regulator-enable-ramp-delay = <0x6e>;
				regulator-max-microvolt = <0x124f80>;
				regulator-min-microvolt = <0x124f80>;
				regulator-name = "vrf12";
			};

			ldo_vrf18 {
				compatible = "regulator-fixed";
				linux,phandle = <0x81>;
				phandle = <0x81>;
				regulator-enable-ramp-delay = <0x6e>;
				regulator-max-microvolt = <0x1b7740>;
				regulator-min-microvolt = <0x1b7740>;
				regulator-name = "vrf18";
			};

			ldo_vsim1 {
				linux,phandle = <0x93>;
				phandle = <0x93>;
				regulator-enable-ramp-delay = <0x108>;
				regulator-max-microvolt = <0x2f4d60>;
				regulator-min-microvolt = <0x19f0a0>;
				regulator-name = "vsim1";
			};

			ldo_vsim2 {
				linux,phandle = <0x94>;
				phandle = <0x94>;
				regulator-enable-ramp-delay = <0x108>;
				regulator-max-microvolt = <0x2f4d60>;
				regulator-min-microvolt = <0x19f0a0>;
				regulator-name = "vsim2";
			};

			ldo_vsram_others {
				linux,phandle = <0x8c>;
				phandle = <0x8c>;
				regulator-enable-ramp-delay = <0x6e>;
				regulator-max-microvolt = <0x1406f4>;
				regulator-min-microvolt = <0x7ea5e>;
				regulator-name = "vsram_others";
				regulator-ramp-delay = <0x186a>;
			};

			ldo_vsram_proc {
				linux,phandle = <0x8d>;
				phandle = <0x8d>;
				regulator-enable-ramp-delay = <0x6e>;
				regulator-max-microvolt = <0x1406f4>;
				regulator-min-microvolt = <0x7ea5e>;
				regulator-name = "vsram_proc";
				regulator-ramp-delay = <0x186a>;
			};

			ldo_vusb33 {
				linux,phandle = <0x96>;
				phandle = <0x96>;
				regulator-enable-ramp-delay = <0x108>;
				regulator-max-microvolt = <0x2f4d60>;
				regulator-min-microvolt = <0x2dc6c0>;
				regulator-name = "vusb33";
			};

			ldo_vxo22 {
				linux,phandle = <0x80>;
				phandle = <0x80>;
				regulator-enable-ramp-delay = <0x6e>;
				regulator-max-microvolt = <0x249f00>;
				regulator-min-microvolt = <0x2191c0>;
				regulator-name = "vxo22";
			};
		};
	};

	mt_soc_anc_pcm {
		compatible = "mediatek,mt_soc_pcm_anc";
	};

	mt_soc_btcvsd_rx_pcm {
		compatible = "mediatek,mt_soc_btcvsd_rx_pcm";
	};

	mt_soc_btcvsd_tx_pcm {
		compatible = "mediatek,mt_soc_btcvsd_tx_pcm";
	};

	mt_soc_codec_dummy_name {
		compatible = "mediatek,mt_soc_codec_dummy";
	};

	mt_soc_codec_name {
		compatible = "mediatek,mt_soc_codec_63xx";
		use_hp_depop_flow = <0x0>;
		use_ul_260k = <0x0>;
	};

	mt_soc_dai_name {
		compatible = "mediatek,mt_soc_dai_stub";
	};

	mt_soc_deep_buffer_dl_pcm {
		compatible = "mediatek,mt_soc_pcm_deep_buffer_dl";
	};

	mt_soc_dl1_awb_pcm {
		compatible = "mediatek,mt_soc_pcm_dl1_awb";
	};

	mt_soc_dl1_pcm@11220000 {
		clock-names = "aud_afe_clk", "aud_dac_clk", "aud_dac_predis_clk", "aud_adc_clk", "aud_apll22m_clk", "aud_apll1_tuner_clk", "aud_tml_clk", "aud_infra_clk", "mtkaif_26m_clk", "top_mux_audio", "top_mux_audio_int", "top_sys_pll1_d4", "top_mux_aud_1", "top_apll1_ck", "top_mux_aud_eng1", "top_apll1_d8", "apmixed_apll1", "top_clk26m_clk";
		clocks = <0x31 0x0 0x31 0x4 0x31 0x5 0x31 0x3 0x31 0x1 0x31 0x2 0x31 0x6 0x19 0x2d 0x19 0x35 0x25 0x34 0x25 0x35 0x25 0x3 0x25 0x38 0x25 0x24 0x25 0x42 0x25 0x27 0x32 0x6 0x26>;
		compatible = "mediatek,mt_soc_pcm_dl1";
		interrupts = <0x0 0x99 0x8>;
		linux,phandle = <0x4d>;
		phandle = <0x4d>;
		reg = <0x0 0x11220000 0x0 0x1000>;
	};

	mt_soc_dl2_pcm {
		compatible = "mediatek,mt_soc_pcm_dl2";
	};

	mt_soc_dummy_pcm {
		compatible = "mediatek,mt_soc_pcm_dummy";
	};

	mt_soc_fm_i2s_awb_pcm {
		compatible = "mediatek,mt_soc_pcm_fm_i2s_awb";
	};

	mt_soc_fm_i2s_pcm {
		compatible = "mediatek,mt_soc_pcm_fm_i2s";
	};

	mt_soc_fm_mrgtx_pcm {
		compatible = "mediatek,mt_soc_pcm_fmtx";
	};

	mt_soc_hdmi_pcm {
		compatible = "mediatek,mt_soc_pcm_hdmi";
	};

	mt_soc_hp_impedance_pcm {
		compatible = "mediatek,mt_soc_pcm_hp_impedance";
	};

	mt_soc_i2s0_awb_pcm {
		compatible = "mediatek,mt_soc_pcm_i2s0_awb";
	};

	mt_soc_i2s0_pcm {
		compatible = "mediatek,mt_soc_pcm_dl1_i2s0";
	};

	mt_soc_i2s0dl1_pcm {
		compatible = "mediatek,mt_soc_pcm_dl1_i2s0dl1";
	};

	mt_soc_mrgrx_awb_pcm {
		compatible = "mediatek,mt_soc_pcm_mrgrx_awb";
	};

	mt_soc_mrgrx_pcm {
		compatible = "mediatek,mt_soc_pcm_mrgrx";
	};

	mt_soc_pcm_voice_ultra {
		compatible = "mediatek,mt_soc_pcm_voice_ultra";
	};

	mt_soc_pcm_voice_usb {
		compatible = "mediatek,mt_soc_pcm_voice_usb";
	};

	mt_soc_pcm_voice_usb_echoref {
		compatible = "mediatek,mt_soc_pcm_voice_usb_echoref";
	};

	mt_soc_routing_dai_name {
		compatible = "mediatek,mt_soc_dai_routing";
	};

	mt_soc_routing_pcm {
		compatible = "mediatek,mt_soc_pcm_routing";
	};

	mt_soc_tdmrx_pcm {
		compatible = "mediatek,mt_soc_tdm_capture";
	};

	mt_soc_ul1_pcm {
		compatible = "mediatek,mt_soc_pcm_capture";
	};

	mt_soc_ul2_pcm {
		compatible = "mediatek,mt_soc_pcm_capture2";
	};

	mt_soc_uldlloopback_pcm {
		compatible = "mediatek,mt_soc_pcm_uldlloopback";
	};

	mt_soc_voice_md1 {
		compatible = "mediatek,mt_soc_pcm_voice_md1";
	};

	mt_soc_voice_md1_bt {
		compatible = "mediatek,mt_soc_pcm_voice_md1_bt";
	};

	mt_soc_voice_md2 {
		compatible = "mediatek,mt_soc_pcm_voice_md2";
	};

	mt_soc_voice_md2_bt {
		compatible = "mediatek,mt_soc_pcm_voice_md2_bt";
	};

	mt_soc_voip_bt_in {
		compatible = "mediatek,mt_soc_pcm_bt_dai";
	};

	mt_soc_voip_bt_out {
		compatible = "mediatek,mt_soc_pcm_dl1_bt";
	};

	mtkfb {
		compatible = "mediatek,mtkfb";
		linux,phandle = <0x52>;
		phandle = <0x52>;
	};

	nfc {
		compatible = "mediatek,nfc-gpio-v2";
		gpio-irq = <0xe>;
		gpio-irq-std = <0x24 0xe 0x0>;
		gpio-rst = <0x7>;
		gpio-rst-std = <0x24 0x7 0x0>;
		linux,phandle = <0x74>;
		phandle = <0x74>;
	};

	nfi@11018000 {
		clock-names = "nfi2x_sel", "nfiecc_sel", "clk26m", "syspll2_d2", "syspll_d7", "syspll_d3", "syspll2_d4", "msdcpll_d2", "univpll1_d2", "univpll_d5", "syspll4_d2", "univpll2_d4", "syspll1_d2", "univpll2_d2", "syspll_d5", "infra_nfiecc", "infra_nfi", "infra_nfi_1x";
		clocks = <0x25 0x3a 0x25 0x3b 0x26 0x25 0x7 0x25 0xc 0x25 0x6 0x25 0x8 0x25 0x23 0x25 0x15 0x25 0x1c 0x25 0xd 0x25 0x19 0x25 0x2 0x25 0x18 0x25 0x9 0x19 0x1e 0x19 0x27 0x19 0x4f>;
		compatible = "mediatek,nfi";
		interrupts = <0x0 0x86 0x8>;
		reg = <0x0 0x11018000 0x0 0x1000>;
	};

	nfiecc@11019000 {
		compatible = "mediatek,nfiecc";
		interrupts = <0x0 0x87 0x8>;
		reg = <0x0 0x11019000 0x0 0x1000>;
	};

	odm {
		compatible = "simple-bus";
		linux,phandle = <0x79>;
		phandle = <0x79>;
	};

	otg_iddig {
		compatible = "mediatek,usb_iddig_bi_eint";
		linux,phandle = <0x6f>;
		phandle = <0x6f>;
	};

	pericfg@10003000 {
		compatible = "mediatek,pericfg";
		reg = <0x0 0x10003000 0x0 0x1000>;
	};

	pinctrl@1000b000 {
		#gpio-cells = <0x2>;
		#interrupt-cells = <0x4>;
		compatible = "mediatek,pinctrl";
		gpio-controller;
		interrupt-controller;
		interrupts = <0x0 0xa7 0x4>;
		linux,phandle = <0x24>;
		mediatek,pctl-regmap = <0xe 0xf 0x10 0x11 0x12 0x13 0x14 0x15>;
		phandle = <0x24>;
		pins-are-numbered;
		reg = <0x0 0x1000b000 0x0 0x1000>;
	};

	pmic_clock_buffer_ctrl {
		compatible = "mediatek,pmic_clock_buffer";
		linux,phandle = <0x5b>;
		mediatek,clkbuf-config = <0x2 0x1 0x1 0x2 0x0 0x0 0x0>;
		mediatek,clkbuf-driving-current = <0xffffffff 0xffffffff 0xffffffff 0xffffffff 0xffffffff 0xffffffff 0xffffffff>;
		mediatek,clkbuf-quantity = <0x7>;
		phandle = <0x5b>;
	};

	pmu {
		compatible = "arm,armv8-pmuv3";
		interrupt-parent = <0x2>;
		interrupts = <0x1 0x7 0x8>;
	};

	psci {
		compatible = "arm,psci-0.2";
		method = "smc";
	};

	pwm@11006000 {
		clock-names = "PWM1-main", "PWM2-main", "PWM3-main", "PWM4-main", "PWM5-main", "PWM6-main", "PWM-HCLK-main", "PWM-main";
		clocks = <0x19 0xe 0x19 0xf 0x19 0x10 0x19 0x11 0x19 0x12 0x19 0x32 0x19 0xd 0x19 0x13>;
		compatible = "mediatek,pwm";
		interrupts = <0x0 0x4d 0x8>;
		reg = <0x0 0x11006000 0x0 0x1000>;
	};

	pwrap@1000d000 {
		compatible = "mediatek,pwrap";
		interrupts = <0x0 0xaf 0x4>;
		reg = <0x0 0x1000d000 0x0 0x1000>;

		pmic_irq {
			compatible = "mediatek,pmic-eint";
			interrupt-controller;
			linux,phandle = <0x3e>;
			phandle = <0x3e>;
		};
	};

	reserved-memory {
		#address-cells = <0x2>;
		#size-cells = <0x2>;
		linux,phandle = <0x3a>;
		phandle = <0x3a>;
		ranges;

		consys-reserve-memory {
			#address-cells = <0x2>;
			#size-cells = <0x2>;
			alignment = <0x0 0x200000>;
			alloc-ranges = <0x0 0x40000000 0x0 0x80000000>;
			compatible = "mediatek,consys-reserve-memory";
			no-map;
			size = <0x0 0x200000>;
		};

		minirdump-reserved-memory@444f0000 {
			compatible = "mediatek,minirdump";
			reg = <0x0 0x444f0000 0x0 0x10000>;
		};

		pstore-reserved-memory@44410000 {
			compatible = "mediatek,pstore";
			reg = <0x0 0x44410000 0x0 0xe0000>;
		};

		ram_console-reserved-memory@44400000 {
			compatible = "mediatek,ram_console";
			reg = <0x0 0x44400000 0x0 0x10000>;
		};
	};

	rt9465_slave_chr {
		linux,phandle = <0x6c>;
		phandle = <0x6c>;
	};

	sar {
		compatible = "mediatek,sar";
		linux,phandle = <0x5e>;
		phandle = <0x5e>;
	};

	sboard_id {
		compatible = "dura_sboardid";
		linux,phandle = <0x71>;
		phandle = <0x71>;
	};

	scpsys@10001000 {
		#clock-cells = <0x1>;
		compatible = "mediatek,scpsys";
		linux,phandle = <0x1a>;
		phandle = <0x1a>;
		reg = <0x0 0x10001000 0x0 0x1000 0x0 0x10006000 0x0 0x1000 0x0 0x1020e000 0x0 0x1000>;
	};

	sdtray_id {
		compatible = "dura_sdtrayid";
		linux,phandle = <0x72>;
		phandle = <0x72>;
	};

	security_ao@1001a000 {
		compatible = "mediatek,security_ao";
		reg = <0x0 0x1001a000 0x0 0x1000>;
	};

	seninf@15008000 {
		compatible = "mediatek,seninf";
		reg = <0x0 0x15008000 0x0 0x1000>;
	};

	sim1_hot_plug {
		linux,phandle = <0x6b>;
		phandle = <0x6b>;
	};

	sleep@10006000 {
		compatible = "mediatek,sleep";
		interrupts = <0x0 0xb1 0x8>;
		reg = <0x0 0x10006000 0x0 0x1000>;
		wakeup-source = <0x16 0x0 0x4 0x17 0x3 0x2000000>;
	};

	sleep_reg_md@1000f000 {
		compatible = "mediatek,sleep_reg_md";
		reg = <0x0 0x1000f000 0x0 0x1000>;
	};

	smi_common@14002000 {
		clock-names = "mtcmos-mm", "smi-common-gals0", "smi-common-gals1", "smi-common", "MMDVFS_CLK_TOP_MMPLL_CK", "mmdvfs_clk_top_vencpll_ck", "mmdvfs_clk_top_syspll2_d2";
		clocks = <0x1a 0x4 0x1b 0x2 0x1b 0x3 0x1b 0x0 0x25 0x2c 0x25 0x21 0x25 0x7>;
		compatible = "mediatek,smi_common";
		larbs = <0x33 0x34 0x35>;
		reg = <0x0 0x14002000 0x0 0x1000>;
	};

	smi_larb0@14003000 {
		clock-names = "mtcmos-mm", "mm-larb0";
		clocks = <0x1a 0x4 0x1b 0x1>;
		compatible = "mediatek,smi_larb0";
		interrupts = <0x0 0xdf 0x8>;
		linux,phandle = <0x33>;
		phandle = <0x33>;
		reg = <0x0 0x14003000 0x0 0x1000>;
	};

	smi_larb1@17010000 {
		clock-names = "mtcmos-ven", "venc-larb", "venc-venc";
		clocks = <0x1a 0x6 0x37 0x0 0x37 0x1>;
		compatible = "mediatek,smi_larb1";
		interrupts = <0x0 0xd5 0x8>;
		linux,phandle = <0x34>;
		phandle = <0x34>;
		reg = <0x0 0x17010000 0x0 0x1000>;
	};

	smi_larb2@15001000 {
		clock-names = "mtcmos-img", "img-larb2";
		clocks = <0x1a 0x5 0x36 0x0>;
		compatible = "mediatek,smi_larb2";
		interrupts = <0x0 0xde 0x8>;
		linux,phandle = <0x35>;
		phandle = <0x35>;
		reg = <0x0 0x15001000 0x0 0x1000>;
	};

	smi_larb3@17010000 {
		compatible = "mediatek,smi_larb3";
		interrupts = <0x0 0xe7 0x8>;
		reg = <0x0 0x17010000 0x0 0x1000>;
	};

	spi2@11010000 {
		compatible = "mediatek,spi2";
		interrupts = <0x0 0x80 0x8>;
		reg = <0x0 0x11010000 0x0 0x1000>;
	};

	spi3@11012000 {
		compatible = "mediatek,spi3";
		interrupts = <0x0 0x81 0x8>;
		reg = <0x0 0x11012000 0x0 0x0>;
	};

	spi4@11013000 {
		compatible = "mediatek,spi4";
		reg = <0x0 0x11013000 0x0 0x1000>;
	};

	spi@1100a000 {
		clock-names = "parent-clk", "sel-clk", "spi-clk";
		clocks = <0x25 0xa 0x25 0x30 0x19 0x1b>;
		compatible = "mediatek,mt6739-spi";
		interrupts = <0x0 0x76 0x8>;
		linux,phandle = <0x48>;
		mediatek,pad-select = <0x0>;
		phandle = <0x48>;
		reg = <0x0 0x1100a000 0x0 0x1000>;
	};

	spi@11010000 {
		clock-names = "parent-clk", "sel-clk", "spi-clk";
		clocks = <0x25 0xa 0x25 0x30 0x19 0x36>;
		compatible = "mediatek,mt6739-spi";
		interrupts = <0x0 0x7a 0x8>;
		linux,phandle = <0x49>;
		mediatek,pad-select = <0x0>;
		phandle = <0x49>;
		reg = <0x0 0x11010000 0x0 0x1000>;
	};

	spi@11012000 {
		clock-names = "parent-clk", "sel-clk", "spi-clk";
		clocks = <0x25 0xa 0x25 0x30 0x19 0x39>;
		compatible = "mediatek,mt6739-spi";
		interrupts = <0x0 0x80 0x8>;
		linux,phandle = <0x4a>;
		mediatek,pad-select = <0x0>;
		phandle = <0x4a>;
		reg = <0x0 0x11012000 0x0 0x1000>;
	};

	sramrom@10214000 {
		compatible = "mediatek,sramrom";
		reg = <0x0 0x10214000 0x0 0x1000>;
	};

	sys_cirq@10204000 {
		compatible = "mediatek,sys_cirq";
		interrupts = <0x0 0xf0 0x8>;
		mediatek,cirq_num = <0xa8>;
		mediatek,spi_start_offset = <0x48>;
		reg = <0x0 0x10204000 0x0 0x1000>;
	};

	sys_timer@10017000 {
		compatible = "mediatek,sys_timer";
		interrupts = <0x0 0xba 0x4>;
		mediatek,sysram-size = <0x14>;
		reg = <0x0 0x10017000 0x0 0x1000 0x0 0x10ffec 0x0 0x14>;
	};

	syscfg_pctl_a@10005000 {
		compatible = "mediatek,pctl-a-syscfg", "syscon";
		linux,phandle = <0xe>;
		phandle = <0xe>;
		reg = <0x0 0x10005000 0x0 0x1000>;
	};

	syscfg_pctl_bl@10002600 {
		compatible = "mediatek,pctl-bl-syscfg", "syscon";
		linux,phandle = <0x12>;
		phandle = <0x12>;
		reg = <0x0 0x10002600 0x0 0x1000>;
	};

	syscfg_pctl_bl@10002c00 {
		compatible = "mediatek,pctl-rt-syscfg", "syscon";
		linux,phandle = <0x15>;
		phandle = <0x15>;
		reg = <0x0 0x10002c00 0x0 0x1000>;
	};

	syscfg_pctl_bm@10002800 {
		compatible = "mediatek,pctl-bm-syscfg", "syscon";
		linux,phandle = <0x13>;
		phandle = <0x13>;
		reg = <0x0 0x10002800 0x0 0x1000>;
	};

	syscfg_pctl_lb@10002400 {
		compatible = "mediatek,pctl-lb-syscfg", "syscon";
		linux,phandle = <0x11>;
		phandle = <0x11>;
		reg = <0x0 0x10002400 0x0 0x1000>;
	};

	syscfg_pctl_lm@10002200 {
		compatible = "mediatek,pctl-lm-syscfg", "syscon";
		linux,phandle = <0x10>;
		phandle = <0x10>;
		reg = <0x0 0x10002200 0x0 0x1000>;
	};

	syscfg_pctl_lt@10002000 {
		compatible = "mediatek,pctl-lt-syscfg", "syscon";
		linux,phandle = <0xf>;
		phandle = <0xf>;
		reg = <0x0 0x10002000 0x0 0x1000>;
	};

	syscfg_pctl_rb@10002a00 {
		compatible = "mediatek,pctl-rb-syscfg", "syscon";
		linux,phandle = <0x14>;
		phandle = <0x14>;
		reg = <0x0 0x10002a00 0x0 0x1000>;
	};

	therm_ctrl@1100b000 {
		clock-names = "therm-main";
		clocks = <0x19 0x8>;
		compatible = "mediatek,therm_ctrl";
		interrupts = <0x0 0x4e 0x8>;
		reg = <0x0 0x1100b000 0x0 0x1000>;
	};

	timer {
		clock-frequency = <0xc65d40>;
		compatible = "arm,armv8-timer";
		interrupt-parent = <0x2>;
		interrupts = <0x1 0xd 0x8 0x1 0xe 0x8 0x1 0xb 0x8 0x1 0xa 0x8>;
	};

	topckgen@10000000 {
		#clock-cells = <0x1>;
		compatible = "mediatek,topckgen", "syscon";
		linux,phandle = <0x25>;
		phandle = <0x25>;
		reg = <0x0 0x10000000 0x0 0x1000 0x0 0x1000c000 0x0 0x1000>;
	};

	topckgen_ao@1001b000 {
		compatible = "mediatek,topckgen_ao";
		reg = <0x0 0x1001b000 0x0 0x1000>;
	};

	topmisc@10011000 {
		compatible = "mediatek,topmisc";
		reg = <0x0 0x10011000 0x0 0x1000>;
	};

	toprgu@10007000 {
		compatible = "mediatek,toprgu";
		interrupts = <0x0 0x8b 0x0>;
		reg = <0x0 0x10007000 0x0 0x1000>;
	};

	touch {
		algo_id = <0x1>;
		bus_id = <0x0>;
		bus_type = "i2c";
		charger_supported = <0x1>;
		compatible = "mediatek,mt6739-touch";
		debounce = <0x6 0x0>;
		linux,phandle = <0x4e>;
		phandle = <0x4e>;
		product = "pandura";
		x_max = <0x2d0>;
		x_max_mt = <0x2d0>;
		y_max = <0x5a0>;
		y_max_mt = <0x5a0>;

		ts_kit {
			compatible = "huawei,ts_kit";

			focaltech@38 {
				algo_id = <0x1>;
				calc_crc_delay = <0x12c>;
				check_status_watchdog_timeout = <0x7d0>;
				chip_id = <0x54>;
				compatible = "fts";
				erase_flash_query_times = <0x64>;
				erase_min_delay = <0x546>;
				erase_query_delay = <0x32>;
				fw_upgrade_delay = <0x2710>;
				gesture_supported = <0x1>;
				glove_switch_addr = <0xc0>;
				hard_reset_delay = <0xc8>;
				ic_type = <0x3>;
				irq_config = <0x3>;
				is_in_cell = <0x0>;
				need_wd_check_status = <0x1>;
				pram_projectid_addr = <0xd7a0>;
				read_ecc_query_times = <0x64>;
				reboot_delay = <0x12c>;
				report_rate_test = <0x0>;
				slave_address = <0x38>;
				support_get_tp_color = <0x1>;
				unite_cap_test_interface = <0x1>;
				upgrade_loop_times = <0x5>;
				write_flash_query_times = <0x1e>;
				x_max = <0x2d0>;
				x_max_mt = <0x2d0>;
				y_max = <0x5a0>;
				y_max_mt = <0x5a0>;

				dura530200 {
					compatible = "fts-dura530200";
					ic_type = <0x2>;
					producer = "truly";
					threshold,cb_test_max = <0xc8>;
					threshold,cb_test_min = <0x1>;
					threshold,lcd_noise_max = <0x64>;
					threshold,raw_data_max = <0x4a38>;
					threshold,raw_data_min = <0x1f40>;
					threshold,scap_raw_data_max = <0x4a38>;
					threshold,scap_raw_data_min = <0x1f40>;
					threshold,short_circuit_min = <0x3e8>;
				};

				dura532300 {
					compatible = "fts-dura532300";
					ic_type = <0x2>;
					need_distinguish_lcd = <0x1>;
					producer = "each";
					threshold,cb_test_max = <0xdc>;
					threshold,cb_test_min = <0x1>;
					threshold,lcd_noise_max = <0x64>;
					threshold,raw_data_max = <0x3a98>;
					threshold,raw_data_min = <0x1388>;
					threshold,scap_raw_data_max = <0x3a98>;
					threshold,scap_raw_data_min = <0x1388>;
					threshold,short_circuit_min = <0x3e8>;
				};

				dura732500 {
					compatible = "fts-dura732500";
					ic_type = <0x3>;
					producer = "txd";
					threshold,cb_test_max = <0xc8>;
					threshold,cb_test_min = <0x1>;
					threshold,lcd_noise_max = <0x64>;
					threshold,raw_data_max = <0x2ee0>;
					threshold,raw_data_min = <0x1770>;
					threshold,scap_raw_data_max = <0x2ee0>;
					threshold,scap_raw_data_min = <0x1770>;
					threshold,short_circuit_min = <0x3e8>;
				};
			};

			goodix_ts@5d {
				algo_id = <0x1>;
				calc_crc_delay = <0x12c>;
				capacitance_test_config = <0x1>;
				check_status_watchdog_timeout = <0x7d0>;
				chip_id = <0x87>;
				compatible = "gtp";
				erase_flash_query_times = <0xf>;
				erase_min_delay = <0x546>;
				erase_query_delay = <0x32>;
				fw_upgrade_delay = <0x2710>;
				gesture_supported = <0x1>;
				glove_switch_addr = <0xc0>;
				goodix,key-max = <0x0>;
				goodix,key-min = <0x0>;
				goodix,key-nc = <0x0>;
				goodix,panel-deviation = <0x12c>;
				goodix,panel-max = <0x19ab>;
				goodix,panel-min = <0xa33>;
				goodix,product_id = "GT917D";
				goodix,shortcircut-threshold = <0x0 0x0 0x0 0x0 0x0 0x0 0x0 0x0>;
				goodix,special_raw_data_limit;
				goodix,test-types = <0x80007>;
				goodix_irq_config = <0x2>;
				hard_reset_delay = <0xc8>;
				ic_type = <0x0>;
				need_wd_check_status = <0x1>;
				read_ecc_query_times = <0x64>;
				reboot_delay = <0x12c>;
				report_rate_test = <0x0>;
				slave_address = <0x5d>;
				support_get_tp_color = <0x1>;
				unite_cap_test_interface = <0x1>;
				upgrade_loop_times = <0x5>;
				write_flash_query_times = <0x1e>;
				x_max = <0x2d0>;
				x_max_mt = <0x2d0>;
				y_max = <0x5a0>;
				y_max_mt = <0x5a0>;
			};

			mstar_ts@26 {
				algo_id = <0x1>;
				capacitance_test_config = <0x1>;
				check_status_watchdog_timeout = <0xbb8>;
				chip_id = <0xbf>;
				compatible = "mstp";
				erase_flash_query_times = <0xf>;
				fw_upgrade_delay = <0x2710>;
				gesture_supported = <0x1>;
				glove_switch_addr = <0xc0>;
				ic_type = <0xbf>;
				mstar,key-max = <0x0>;
				mstar,key-min = <0x0>;
				mstar,key-nc = <0x0>;
				mstar,panel-deviation = <0xabe0>;
				mstar,panel-max = <0x800>;
				mstar,panel-min = <0x800>;
				mstar,product_id = "MSG2836A";
				mstar,test-types = <0x80007>;
				mstar_irq_config = <0x3>;
				mstar_mp_flow = <0x2>;
				mstar_mp_retry = <0x3>;
				need_wd_check_status = <0x1>;
				rawdata_timeout = <0xa>;
				read_ecc_query_times = <0x64>;
				report_rate_test = <0x0>;
				slave_address = <0x26>;
				support_get_tp_color = <0x1>;
				unite_cap_test_interface = <0x1>;
				upgrade_loop_times = <0x5>;
				write_flash_query_times = <0x1e>;
				x_max = <0x2d0>;
				x_max_mt = <0x2d0>;
				y_max = <0x5a0>;
				y_max_mt = <0x5a0>;

				dura292600 {
					compatible = "mstp-dura292600";
					producer = "hlt";
				};
			};
		};
	};

	trng@1020f000 {
		compatible = "mediatek,trng";
		interrupts = <0x0 0xa1 0x8>;
		reg = <0x0 0x1020f000 0x0 0x1000>;
	};

	trusty {
		#address-cells = <0x2>;
		#size-cells = <0x2>;
		compatible = "android,trusty-smc-v1";
		ranges;

		irq {
			compatible = "android,trusty-irq-v1";
			ppi-interrupt-parent = <0x2>;
		};

		log {
			compatible = "android,trusty-log-v1";
		};

		mtee {
			compatible = "mediatek,trusty-mtee-v1";
		};

		virtio {
			compatible = "android,trusty-virtio-v1";
		};
	};

	usb0@11200000 {
		clock-names = "usb0", "usb0_clk_top_sel", "usb0_clk_univpll3_d4";
		clocks = <0x19 0x6 0x25 0x3c 0x25 0x1e>;
		compatible = "mediatek,mt6739-usb20";
		interrupts = <0x0 0x49 0x8>;
		mode = <0x2>;
		multipoint = <0x1>;
		num_eps = <0x10>;
		reg = <0x0 0x11200000 0x0 0x10000 0x0 0x11cc0000 0x0 0x10000>;
	};

	utos {
		compatible = "microtrust,utos";
		interrupts = <0x0 0x83 0x1 0x0 0x84 0x1>;
	};

	vdec@17040000 {
		compatible = "mediatek,vdec";
		interrupts = <0x0 0xd7 0x8>;
		reg = <0x0 0x17040000 0x0 0x10000>;
	};

	vdec_gcon@17000000 {
		clock-names = "MT_CG_VDEC", "MT_CG_VENC", "MT_SCP_SYS_VDE", "MT_SCP_SYS_VEN";
		clocks = <0x37 0x3 0x37 0x1 0x1a 0x6 0x1a 0x6>;
		compatible = "mediatek,vdec_gcon";
		reg = <0x0 0x17000000 0x0 0x1000>;
	};

	venc@17020000 {
		compatible = "mediatek,venc";
		interrupts = <0x0 0xd4 0x8>;
		linux,phandle = <0x56>;
		phandle = <0x56>;
		reg = <0x0 0x17020000 0x0 0x1000>;
	};

	venc_global_con@17000000 {
		#clock-cells = <0x1>;
		compatible = "mediatek,venc_global_con", "syscon";
		linux,phandle = <0x37>;
		phandle = <0x37>;
		reg = <0x0 0x17000000 0x0 0x10000>;
	};

	venc_jpg@17030000 {
		clock-names = "MT_CG_VENC_JPGENC";
		clocks = <0x37 0x2>;
		compatible = "mediatek,venc_jpg";
		interrupts = <0x0 0xd6 0x8>;
		reg = <0x0 0x17030000 0x0 0x1000>;
	};

	wifi@180f0000 {
		clock-names = "wifi-dma";
		clocks = <0x19 0x28>;
		compatible = "mediatek,wifi";
		dma_addrmask = <0x24>;
		interrupts = <0x0 0xea 0x8>;
		reg = <0x0 0x180f0000 0x0 0x5c>;
	};
};
